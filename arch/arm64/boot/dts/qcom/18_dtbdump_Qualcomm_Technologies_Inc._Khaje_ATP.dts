/dts-v1/;

/ {
	model = "Qualcomm Technologies, Inc. Khaje ATP";
	compatible = "qcom,khaje-atp\0qcom,khaje\0qcom,atp";
	qcom,msm-id = <0x206 0x10000 0x24a 0x10000>;
	qcom,board-id = <0x21 0x00>;
	qcom,pmic-id = <0x2d 0x2e 0x00 0x00>;

	fragment@0 {
		target = <0xffffffff>;

		__overlay__ {
			qcom,num-macros = <0x03>;
			qcom,bolero-version = <0x05>;

			bolero-clk-rsc-mngr {
				compatible = "qcom,bolero-clk-rsc-mngr";
				qcom,fs-gen-sequence = <0x3000 0x01 0x3004 0x01 0x3080 0x02>;
				qcom,rx_mclk_mode_muxsel = <0xa5640d8>;
				qcom,va_mclk_mode_muxsel = "\nz\0";
				clock-names = "tx_core_clk\0tx_npl_clk\0rx_core_clk\0rx_npl_clk\0va_core_clk\0va_npl_clk";
				clocks = <0x01 0x00 0x02 0x00 0x03 0x00 0x04 0x00 0x05 0x00 0x06 0x00>;
			};

			tx-macro@a620000 {
				compatible = "qcom,tx-macro";
				reg = <0xa620000 0x00>;
				clock-names = "tx_core_clk\0tx_npl_clk";
				clocks = <0x01 0x00 0x02 0x00>;
				qcom,tx-dmic-sample-rate = <0x249f00>;
				qcom,is-used-swr-gpio = <0x00>;
				phandle = <0x22>;
			};

			rx-macro@a600000 {
				compatible = "qcom,rx-macro";
				reg = <0xa600000 0x00>;
				clock-names = "rx_core_clk\0rx_npl_clk";
				clocks = <0x03 0x00 0x04 0x00>;
				qcom,rx-swr-gpios = <0xffffffff>;
				qcom,rx_mclk_mode_muxsel = <0xa5640d8>;
				qcom,rx-bcl-pmic-params = [00 04 3e];
				qcom,default-clk-id = <0x00>;
				phandle = <0x23>;

				rx_swr_master {
					compatible = "qcom,swr-mstr";
					#address-cells = <0x02>;
					#size-cells = <0x00>;
					clock-names = "lpass_audio_hw_vote";
					clocks = <0xffffffff 0x00>;
					qcom,swr_master_id = <0x02>;
					qcom,swrm-hctl-reg = <0xa6a9098>;
					qcom,mipi-sdw-block-packing-mode = <0x01>;
					swrm-io-base = <0xa610000 0x00>;
					interrupts = <0x00 0x129 0x04>;
					interrupt-names = "swr_master_irq";
					qcom,swr-num-ports = <0x05>;
					qcom,swr-port-mapping = <0x01 0x09 0x01 0x01 0x0a 0x02 0x02 0x0d 0x01 0x03 0x0b 0x01 0x03 0x0c 0x02 0x04 0x0e 0x01 0x05 0x0f 0x01 0x05 0x10 0x02>;
					qcom,swr-num-dev = <0x01>;
					qcom,disable-div2-clk-switch = <0x01>;
					qcom,swr-clock-stop-mode0 = <0x01>;
					phandle = <0x24>;

					wcd937x-rx-slave {
						compatible = "qcom,wcd937x-slave";
						reg = <0x0a 0x1170224>;
						phandle = <0x08>;
					};
				};
			};

			va-macro@a730000 {
				compatible = "qcom,va-macro";
				reg = <0xa730000 0x00>;
				clock-names = "lpass_audio_hw_vote";
				clocks = <0xffffffff 0x00>;
				qcom,va-dmic-sample-rate = <0x927c0>;
				qcom,va-clk-mux-select = <0x01>;
				qcom,va-island-mode-muxsel = "\nz\0";
				qcom,default-clk-id = <0x00>;
				qcom,is-used-swr-gpio = <0x01>;
				qcom,va-swr-gpios = <0xffffffff>;
				phandle = <0x25>;

				va_swr_master {
					compatible = "qcom,swr-mstr";
					#address-cells = <0x02>;
					#size-cells = <0x00>;
					clock-names = "lpass_audio_hw_vote";
					clocks = <0xffffffff 0x00>;
					qcom,swr_master_id = <0x03>;
					qcom,swrm-hctl-reg = <0xa7ec100>;
					qcom,mipi-sdw-block-packing-mode = <0x01>;
					swrm-io-base = <0xa740000 0x00>;
					interrupts = <0x00 0x128 0x04 0x00 0x4f 0x04>;
					interrupt-names = "swr_master_irq\0swr_wake_irq";
					qcom,swr-wakeup-required = <0x01>;
					qcom,swr-num-ports = <0x03>;
					qcom,swr-port-mapping = <0x01 0x12 0x01 0x01 0x13 0x02 0x01 0x14 0x04 0x01 0x15 0x08 0x02 0x16 0x01 0x02 0x17 0x02 0x02 0x18 0x04 0x02 0x19 0x08 0x03 0x1a 0x01 0x03 0x1b 0x02 0x03 0x1c 0x04 0x03 0x1d 0x08>;
					qcom,swr-num-dev = <0x01>;
					qcom,swr-clock-stop-mode0 = <0x01>;
					qcom,swr-mstr-irq-wakeup-capable = <0x01>;
					phandle = <0x26>;

					wcd937x-tx-slave {
						compatible = "qcom,wcd937x-slave";
						reg = <0x0a 0x1170223>;
						phandle = <0x09>;
					};
				};
			};

			wcd937x-codec {
				compatible = "qcom,wcd937x-codec";
				qcom,split-codec = <0x01>;
				qcom,rx_swr_ch_map = <0x00 0x09 0x01 0x00 0x09 0x00 0x0a 0x02 0x00 0x0a 0x01 0x0d 0x01 0x00 0x0d 0x02 0x0b 0x01 0x00 0x0b 0x02 0x0c 0x02 0x00 0x0c 0x03 0x0e 0x01 0x00 0x0e 0x04 0x0f 0x01 0x00 0x0f 0x04 0x10 0x02 0x00 0x10>;
				qcom,tx_swr_ch_map = <0x00 0x12 0x01 0x00 0x12 0x01 0x13 0x01 0x00 0x16 0x01 0x14 0x02 0x00 0x17 0x02 0x16 0x01 0x00 0x1a 0x02 0x17 0x02 0x00 0x1b 0x02 0x11 0x04 0x00 0x1c 0x03 0x18 0x01 0x00 0x1a 0x03 0x19 0x02 0x00 0x1b 0x03 0x1a 0x04 0x00 0x1c 0x03 0x1b 0x08 0x00 0x1d>;
				qcom,wcd-rst-gpio-node = <0x07>;
				qcom,rx-slave = <0x08>;
				qcom,tx-slave = <0x09>;
				cdc-vdd-rxtx-supply = <0xffffffff>;
				qcom,cdc-vdd-rxtx-voltage = <0x1b7740 0x1b7740>;
				qcom,cdc-vdd-rxtx-current = <0x2710>;
				cdc-vddpx-supply = <0xffffffff>;
				qcom,cdc-vddpx-voltage = <0x1b7740 0x1b7740>;
				qcom,cdc-vddpx-current = <0x4e20>;
				cdc-vdd-buck-supply = <0xffffffff>;
				qcom,cdc-vdd-buck-voltage = <0x1b7740 0x1b7740>;
				qcom,cdc-vdd-buck-current = <0x9eb10>;
				qcom,cdc-micbias1-mv = <0xa8c>;
				qcom,cdc-micbias2-mv = <0xa8c>;
				qcom,cdc-micbias3-mv = <0xa8c>;
				qcom,cdc-static-supplies = "cdc-vdd-rxtx\0cdc-vddpx";
				qcom,cdc-on-demand-supplies = "cdc-vdd-buck";
				phandle = <0x0a>;
			};
		};
	};

	fragment@1 {
		target = <0xffffffff>;

		__overlay__ {
			qcom,model = "bengal-idp-snd-card";
			qcom,msm-mi2s-master = <0x01 0x01 0x01 0x01>;
			qcom,wcn-btfm = <0x01>;
			qcom,va-bolero-codec = <0x01>;
			qcom,rxtx-bolero-codec = <0x01>;
			qcom,audio-routing = "AMIC1\0MIC BIAS1\0MIC BIAS1\0Analog Mic1\0AMIC2\0MIC BIAS2\0MIC BIAS2\0Analog Mic2\0AMIC3\0MIC BIAS3\0MIC BIAS3\0Analog Mic3\0AMIC4\0MIC BIAS3\0MIC BIAS3\0Analog Mic4\0TX DMIC0\0MIC BIAS1\0MIC BIAS1\0Digital Mic0\0TX DMIC1\0MIC BIAS1\0MIC BIAS1\0Digital Mic1\0TX DMIC2\0MIC BIAS3\0MIC BIAS3\0Digital Mic2\0TX DMIC3\0MIC BIAS3\0MIC BIAS3\0Digital Mic3\0IN1_HPHL\0HPHL_OUT\0IN2_HPHR\0HPHR_OUT\0IN3_AUX\0AUX_OUT\0SpkrMono WSA_IN\0AUX\0TX SWR_MIC0\0ADC1_OUTPUT\0TX SWR_MIC4\0ADC2_OUTPUT\0TX SWR_MIC5\0ADC3_OUTPUT\0TX SWR_MIC8\0DMIC1_OUTPUT\0TX SWR_MIC9\0DMIC2_OUTPUT\0TX SWR_MIC8\0DMIC3_OUTPUT\0TX SWR_MIC9\0DMIC4_OUTPUT\0TX SWR_MIC10\0DMIC5_OUTPUT\0TX SWR_MIC11\0DMIC6_OUTPUT\0TX SWR_MIC0\0VA_TX_SWR_CLK\0TX SWR_MIC1\0VA_TX_SWR_CLK\0TX SWR_MIC2\0VA_TX_SWR_CLK\0TX SWR_MIC3\0VA_TX_SWR_CLK\0TX SWR_MIC4\0VA_TX_SWR_CLK\0TX SWR_MIC5\0VA_TX_SWR_CLK\0TX SWR_MIC6\0VA_TX_SWR_CLK\0TX SWR_MIC7\0VA_TX_SWR_CLK\0TX SWR_MIC8\0VA_TX_SWR_CLK\0TX SWR_MIC9\0VA_TX_SWR_CLK\0TX SWR_MIC10\0VA_TX_SWR_CLK\0TX SWR_MIC11\0VA_TX_SWR_CLK\0RX_TX DEC0_INP\0TX DEC0 MUX\0RX_TX DEC1_INP\0TX DEC1 MUX\0RX_TX DEC2_INP\0TX DEC2 MUX\0RX_TX DEC3_INP\0TX DEC3 MUX\0TX_AIF1 CAP\0VA_TX_SWR_CLK\0TX_AIF2 CAP\0VA_TX_SWR_CLK\0TX_AIF3 CAP\0VA_TX_SWR_CLK\0VA DMIC0\0VA MIC BIAS1\0VA DMIC1\0VA MIC BIAS1\0VA DMIC2\0VA MIC BIAS3\0VA DMIC3\0VA MIC BIAS3\0VA MIC BIAS1\0Digital Mic0\0VA MIC BIAS1\0Digital Mic1\0VA MIC BIAS3\0Digital Mic2\0VA MIC BIAS3\0Digital Mic3\0VA SWR_MIC0\0ADC1_OUTPUT\0VA SWR_MIC4\0ADC2_OUTPUT\0VA SWR_MIC5\0ADC3_OUTPUT\0VA SWR_MIC8\0DMIC1_OUTPUT\0VA SWR_MIC9\0DMIC2_OUTPUT\0VA SWR_MIC8\0DMIC3_OUTPUT\0VA SWR_MIC9\0DMIC4_OUTPUT\0VA SWR_MIC10\0DMIC5_OUTPUT\0VA SWR_MIC11\0DMIC6_OUTPUT";
			qcom,msm-mbhc-hphl-swh = <0x01>;
			qcom,msm-mbhc-gnd-swh = <0x01>;
			qcom,cdc-dmic01-gpios = <0xffffffff>;
			qcom,cdc-dmic23-gpios = <0xffffffff>;
			nvmem-cells = <0xffffffff>;
			nvmem-cell-names = "adsp_variant";
			asoc-codec = <0xffffffff 0xffffffff>;
			asoc-codec-names = "msm-stub-codec.1\0bolero_codec";
			qcom,wsa-max-devs = <0x00>;
			qcom,wsa-devs = <0x00>;
			qcom,wsa-aux-dev-prefix = "SpkrMono";
			qcom,codec-max-aux-devs = <0x01>;
			qcom,codec-aux-devs = <0x0a>;
			qcom,msm_audio_ssr_devs = <0xffffffff 0xffffffff 0xffffffff 0xffffffff>;
		};
	};

	fragment@2 {
		target = <0xffffffff>;

		__overlay__ {

			wsa881x-i2c-codec@e {
				compatible = "qcom,wsa881x-i2c-codec";
				reg = <0x0e>;
				clock-names = "wsa_mclk";
				clocks = <0x0b 0x00>;
				qcom,wsa-analog-clk-gpio = <0xffffffff>;
				qcom,wsa-analog-reset-gpio = <0x0c>;
				status = "disable";
				phandle = <0x27>;
			};

			wsa881x-i2c-codec@44 {
				compatible = "qcom,wsa881x-i2c-codec";
				reg = <0x44>;
				status = "disable";
				phandle = <0x28>;
			};

			fsa4480@42 {
				status = "disable";
				phandle = <0x29>;
			};

			aw87xxx_pa_5B@5B {
				compatible = "awinic,aw87xxx_pa";
				reg = <0x5b>;
				reset-gpio = <0xffffffff 0x23 0x00>;
				dev_index = <0x00>;
				status = "okay";
			};

			aw87xxx_pa_58@58 {
				compatible = "awinic,aw87xxx_pa";
				reg = <0x58>;
				reset-gpio = <0xffffffff 0x6a 0x00>;
				dev_index = <0x01>;
				status = "okay";
			};
		};
	};

	fragment@3 {
		target = <0xffffffff>;

		__overlay__ {

			msm_cdc_pinctrl@92 {
				compatible = "qcom,msm-cdc-pinctrl";
				pinctrl-names = "aud_active\0aud_sleep";
				pinctrl-0 = <0xffffffff>;
				pinctrl-1 = <0xffffffff>;
				phandle = <0x07>;
			};

			msm_cdc_pinctrl@106 {
				compatible = "qcom,msm-cdc-pinctrl";
				pinctrl-names = "aud_active\0aud_sleep";
				pinctrl-0 = <0xffffffff>;
				pinctrl-1 = <0xffffffff>;
				phandle = <0x0c>;
			};

			aw87xxx_pa_reset_gpio {
				compatible = "longcheer,lct_pinctrl";
				audio-reset-pin = <0x0c>;
				status = "okay";
			};

			wsa_ana_clk {
				compatible = "qcom,audio-ref-clk";
				qcom,codec-ext-clk-src = <0x03>;
				qcom,codec-lpass-ext-clk-freq = <0x927c00>;
				qcom,codec-lpass-clk-id = <0x301>;
				#clock-cells = <0x01>;
				status = "disable";
				phandle = <0x0b>;
			};

			rx_core_clk {
				compatible = "qcom,audio-ref-clk";
				qcom,codec-ext-clk-src = <0x05>;
				qcom,codec-lpass-ext-clk-freq = <0x1588800>;
				qcom,codec-lpass-clk-id = <0x30e>;
				#clock-cells = <0x01>;
				phandle = <0x03>;
			};

			rx_npl_clk {
				compatible = "qcom,audio-ref-clk";
				qcom,codec-ext-clk-src = <0x06>;
				qcom,codec-lpass-ext-clk-freq = <0x1588800>;
				qcom,codec-lpass-clk-id = <0x30f>;
				#clock-cells = <0x01>;
				phandle = <0x04>;
			};

			tx_core_clk {
				compatible = "qcom,audio-ref-clk";
				qcom,codec-ext-clk-src = <0x07>;
				qcom,codec-lpass-ext-clk-freq = <0x124f800>;
				qcom,codec-lpass-clk-id = <0x30c>;
				#clock-cells = <0x01>;
				phandle = <0x01>;
			};

			tx_npl_clk {
				compatible = "qcom,audio-ref-clk";
				qcom,codec-ext-clk-src = <0x08>;
				qcom,codec-lpass-ext-clk-freq = <0x124f800>;
				qcom,codec-lpass-clk-id = <0x30d>;
				#clock-cells = <0x01>;
				phandle = <0x02>;
			};

			va_core_clk {
				compatible = "qcom,audio-ref-clk";
				qcom,codec-ext-clk-src = <0x02>;
				qcom,codec-lpass-ext-clk-freq = <0x124f800>;
				qcom,codec-lpass-clk-id = <0x30b>;
				#clock-cells = <0x01>;
				phandle = <0x05>;
			};

			va_npl_clk {
				compatible = "qcom,audio-ref-clk";
				qcom,codec-ext-clk-src = <0x0a>;
				qcom,codec-lpass-ext-clk-freq = <0x124f800>;
				qcom,codec-lpass-clk-id = <0x310>;
				#clock-cells = <0x01>;
				phandle = <0x06>;
			};
		};
	};

	fragment@4 {
		target = <0xffffffff>;

		__overlay__ {
			qcom,msm-dai-is-island-supported = <0x01>;
		};
	};

	fragment@5 {
		target = <0xffffffff>;

		__overlay__ {
			nvmem-cells = <0xffffffff>;
			nvmem-cell-names = "adsp_variant";
			adsp-fw-names = "adsp2";
			adsp-fw-bit-values = <0x01>;
		};
	};

	fragment@6 {
		target = <0xffffffff>;

		__overlay__ {

			qcom,mdss_dsi_td4330_truly_v2_cmd {
				qcom,mdss-dsi-panel-name = "td4330 v2 cmd mode dsi truly panel";
				qcom,mdss-dsi-panel-type = "dsi_cmd_mode";
				qcom,dsi-ctrl-num = <0x00>;
				qcom,dsi-phy-num = <0x00>;
				qcom,mdss-dsi-panel-mode-switch;
				qcom,mdss-dsi-virtual-channel-id = <0x00>;
				qcom,mdss-dsi-stream = <0x00>;
				qcom,mdss-dsi-bpp = <0x18>;
				qcom,mdss-dsi-color-order = "rgb_swap_rgb";
				qcom,mdss-dsi-underflow-color = <0xff>;
				qcom,mdss-dsi-border-color = <0x00>;
				qcom,mdss-dsi-h-sync-pulse = <0x00>;
				qcom,mdss-dsi-traffic-mode = "non_burst_sync_event";
				qcom,mdss-dsi-lane-map = "lane_map_0123";
				qcom,mdss-dsi-bllp-eof-power-mode;
				qcom,mdss-dsi-bllp-power-mode;
				qcom,mdss-dsi-tx-eot-append;
				qcom,mdss-dsi-lane-0-state;
				qcom,mdss-dsi-lane-1-state;
				qcom,mdss-dsi-lane-2-state;
				qcom,mdss-dsi-lane-3-state;
				qcom,mdss-dsi-dma-trigger = "trigger_sw";
				qcom,mdss-dsi-mdp-trigger = "none";
				qcom,mdss-dsi-lp11-init;
				qcom,mdss-dsi-bl-pmic-control-type = "bl_ctrl_wled";
				qcom,mdss-dsi-bl-min-level = <0x01>;
				qcom,mdss-dsi-bl-max-level = <0xfff>;
				qcom,mdss-dsi-reset-sequence = <0x01 0x0a 0x00 0x0a 0x01 0x0a>;
				qcom,mdss-dsi-te-pin-select = <0x01>;
				qcom,mdss-dsi-wr-mem-start = <0x2c>;
				qcom,mdss-dsi-wr-mem-continue = <0x3c>;
				qcom,mdss-dsi-te-dcs-command = <0x01>;
				qcom,mdss-dsi-te-check-enable;
				qcom,mdss-dsi-te-using-te-pin;
				phandle = <0x2a>;

				qcom,mdss-dsi-display-timings {

					timing@0 {
						qcom,mdss-dsi-cmd-mode;
						qcom,mdss-dsi-panel-width = <0x438>;
						qcom,mdss-dsi-panel-height = <0x8e8>;
						qcom,mdss-dsi-h-front-porch = <0x50>;
						qcom,mdss-dsi-h-back-porch = <0x50>;
						qcom,mdss-dsi-h-pulse-width = <0x14>;
						qcom,mdss-dsi-h-sync-skew = <0x00>;
						qcom,mdss-dsi-v-back-porch = <0x0d>;
						qcom,mdss-dsi-v-front-porch = <0x10>;
						qcom,mdss-dsi-v-pulse-width = <0x02>;
						qcom,mdss-dsi-panel-framerate = <0x3c>;
						qcom,mdss-dsi-panel-jitter = <0x04 0x01>;
						qcom,mdss-dsi-on-command = [29 01 00 00 00 00 02 b0 00 29 01 00 00 00 00 0d b6 30 6b 00 06 03 0a 13 1a 6c 18 19 02 29 01 00 00 00 00 05 b7 40 00 00 00 29 01 00 00 00 00 08 b8 57 3d 19 be 1e 0a 0a 29 01 00 00 00 00 08 b9 6f 3d 28 be 3c 14 0a 29 01 00 00 00 00 08 ba b5 33 41 be 64 23 0a 29 01 00 00 00 00 0c bb 44 26 c3 1f 19 06 03 c0 00 00 10 29 01 00 00 00 00 0c bc 32 4c c3 52 32 1f 03 f2 00 00 13 29 01 00 00 00 00 0c bd 24 68 c3 aa 3f 32 03 ff 00 00 25 29 01 00 00 00 00 0d be 00 00 00 00 00 00 00 00 00 00 00 00 29 01 00 00 00 00 0d c0 00 dc 00 dc 04 08 e8 00 04 00 03 78 29 01 00 00 00 00 24 c1 30 00 00 11 11 00 00 00 22 00 05 20 fa 00 08 00 00 00 00 00 00 00 00 00 00 00 00 00 00 00 00 00 00 00 00 29 01 00 00 00 00 79 c2 06 e0 6e 01 03 00 02 00 00 00 00 00 00 00 00 00 00 00 00 00 00 00 00 00 00 00 00 00 00 00 00 00 00 00 00 00 00 00 00 00 00 11 00 00 00 00 04 a0 c9 00 00 00 00 00 00 48 eb 00 00 01 00 00 00 11 00 00 00 00 00 00 00 00 00 00 00 00 00 00 00 00 00 00 00 00 11 00 00 00 00 00 00 dc 00 00 00 00 04 00 08 ef 00 00 00 00 00 11 00 00 00 00 00 00 00 00 00 00 00 00 00 00 29 01 00 00 00 00 6d c3 00 00 00 00 00 00 00 00 00 00 00 00 00 00 00 00 00 00 00 00 00 00 00 00 00 00 00 00 00 00 00 00 00 00 00 00 00 00 00 00 00 00 00 00 00 00 00 00 00 00 00 00 00 00 00 00 00 00 00 00 00 00 aa aa aa 00 00 00 00 00 00 00 00 00 00 00 00 00 00 00 00 00 00 00 00 00 00 00 00 00 00 00 00 00 00 00 00 00 00 00 00 00 00 00 00 00 00 00 29 01 00 00 00 00 62 c4 00 4c 00 3f 00 83 00 00 87 86 85 84 00 00 00 00 00 61 5d 5f 00 5e 60 62 00 00 00 02 00 83 00 00 87 86 85 84 00 00 00 00 00 61 5d 5f 00 5e 60 62 ff ff ff ff ff ff 00 0f 0e 00 0f 0e 00 00 00 00 00 00 00 0f ee 00 0f ee 00 00 e0 00 00 e0 0e 00 00 00 0e 00 00 00 00 00 ff 57 00 00 00 00 00 00 00 29 01 00 00 00 00 06 c5 08 00 00 00 00 29 01 00 00 00 00 3a c6 02 0a 08 fc ff ff ff 00 00 13 01 f0 0c 06 01 43 43 43 00 00 00 01 77 09 28 28 06 01 43 43 43 00 00 00 01 61 00 00 00 1c 01 00 00 00 00 00 00 00 00 00 00 00 00 20 20 00 00 29 01 00 00 00 00 4d c7 00 00 00 e0 01 e9 02 7e 02 05 02 90 02 f6 02 40 02 5c 02 77 02 c8 02 1b 02 5b 02 bd 02 27 02 c3 03 54 03 d8 03 ff 00 00 00 e0 01 e9 02 7e 02 05 02 90 02 f6 02 40 02 5c 02 77 02 c8 02 1b 02 5b 02 bd 02 27 02 c3 03 54 03 d8 03 ff 29 01 00 00 00 00 42 c8 41 00 ff fa 00 ff 00 00 fe f6 fe e9 00 00 ff f7 fb e1 00 00 00 00 00 ff 00 00 ff fa 00 ff 00 fe f6 fe e9 00 ff f7 fb e1 00 00 00 00 ff 00 ff fa 00 ff 00 fe f6 fe e9 00 ff f7 fb e1 00 00 00 00 ff 29 01 00 00 00 00 19 c9 00 ff fa 00 ff 00 00 fe f6 fe e9 00 00 ff f7 fb e1 00 00 00 00 00 ff 00 29 01 00 00 00 00 42 ca 1c fc fc fc 00 00 00 00 00 00 00 00 00 00 00 00 00 00 00 00 00 00 00 00 00 00 00 00 00 00 00 00 00 00 00 00 00 00 00 00 00 00 00 00 00 00 00 00 00 00 00 00 00 00 00 00 00 00 00 00 00 00 00 00 00 29 01 00 00 00 00 0b cc 00 00 4d 8b 55 4d 8b aa 4d 8b 29 01 00 00 00 00 02 cd 00 29 01 00 00 00 00 24 ce 5d 40 49 53 59 5e 63 68 6e 74 7e 8a 98 a8 bb d0 e7 ff 04 00 04 04 42 04 69 5a 40 11 f4 00 00 84 fa 00 00 29 01 00 00 00 00 07 cf 00 00 80 46 61 00 29 01 00 00 00 00 12 d0 f6 95 11 b1 55 cf 00 f6 d3 11 f0 01 12 cf 02 20 11 29 01 00 00 00 00 23 d1 d3 d3 33 33 07 03 3b 33 77 37 77 37 35 77 07 77 f7 33 73 07 33 33 03 33 1b 03 32 3d 0a 30 13 13 20 00 29 01 00 00 00 00 05 d2 00 00 07 00 29 01 00 00 00 00 9a d3 03 00 00 00 00 00 00 0f 00 57 00 00 32 00 00 1a 70 01 19 80 01 01 f0 02 00 e0 06 ff f7 ff ff f7 ff ff f7 ff ff f7 ff ff f7 ff ff f7 ff ff f7 ff ff f7 ff ff f7 ff ff f7 ff ff f7 ff ff f7 ff ff f7 ff ff f7 ff ff f7 ff ff f7 ff ff f7 ff ff f7 ff ff f7 ff ff f7 ff ff f7 ff ff f7 ff ff f7 ff ff f7 ff ff f7 ff ff f7 ff ff f7 ff ff f7 ff ff f7 ff ff f7 ff ff f7 ff ff f7 ff ff f7 ff ff f7 ff ff f7 ff ff f7 ff ff f7 ff ff f7 ff ff f7 ff ff f7 ff ff f7 ff ff f7 ff 29 01 00 00 00 00 05 e5 03 00 00 00 29 01 00 00 00 00 09 d5 02 42 02 42 02 dc 02 dc 29 01 00 00 00 00 02 d6 c0 29 01 00 00 00 00 32 d7 21 10 52 52 00 b6 04 fd 00 b6 04 fd 00 82 80 83 84 85 83 80 84 45 85 85 85 87 04 06 02 04 04 07 10 0c 0b 0a 0a 07 06 00 08 00 00 00 00 00 00 00 00 29 01 00 00 00 00 05 dd 30 06 23 65 29 01 00 00 00 00 0d de 00 00 00 0f ff 00 00 00 00 00 00 10 29 01 00 00 00 00 02 e3 ff 29 01 00 00 00 00 07 e6 00 00 00 00 00 00 29 01 00 00 00 00 0b e7 50 04 00 00 00 00 00 00 00 00 29 01 00 00 00 00 05 e8 00 01 23 00 29 01 00 00 00 00 1e ea 01 02 47 80 47 00 00 00 05 00 13 60 02 47 80 47 00 00 00 00 13 60 00 11 00 30 10 21 02 29 01 00 00 00 00 08 eb 00 00 00 00 01 00 11 29 01 00 00 00 00 04 ec 00 00 00 29 01 00 00 00 00 21 ed 01 01 02 02 02 02 00 00 00 00 00 00 0a 00 00 00 00 10 00 18 00 18 00 b0 00 00 00 00 00 da 10 00 29 01 00 00 00 00 61 ee 03 0f 00 00 00 00 40 1f 00 00 0f f2 3f 00 00 00 00 00 00 00 00 00 00 00 00 00 00 00 10 01 00 09 01 8c d8 ef 00 00 00 00 00 00 00 00 00 00 00 00 00 00 00 00 00 00 50 1f 00 00 00 00 00 00 00 00 00 00 00 00 00 00 00 00 00 00 00 00 00 00 00 00 00 00 00 00 00 00 00 00 00 00 00 00 00 00 00 00 29 01 00 00 00 00 8c ef 00 70 4a 08 d0 00 00 00 00 3c 3c 3c 00 00 00 00 00 00 00 00 00 00 00 00 00 00 00 00 70 4a 08 d0 00 00 00 00 3c 3c 3c 00 00 00 00 00 00 00 00 00 00 00 00 00 00 00 00 00 00 00 00 00 00 00 00 00 00 00 00 00 00 00 00 00 00 00 00 00 00 00 00 00 00 00 00 00 00 00 00 00 00 00 00 00 03 08 ec 50 10 00 10 00 0a 0a 00 00 00 00 10 0f 00 03 51 00 50 00 00 00 00 00 00 00 00 00 00 00 00 00 00 00 00 00 00 00 00 00 00 00 03 08 ec 29 01 00 00 00 00 02 b0 03 29 01 00 00 00 00 02 b0 04 29 01 00 00 00 00 02 d6 00 39 01 00 00 00 00 03 51 ff f0 39 01 00 00 00 00 02 53 0c 39 01 00 00 00 00 02 55 00 39 01 00 00 00 00 02 35 00 39 01 00 00 00 00 05 2a 00 00 04 37 39 01 00 00 00 00 05 2b 00 00 08 e7 05 01 00 00 ff 00 02 29 00 05 01 00 00 ff 00 02 11 00];
						qcom,mdss-dsi-off-command = [05 01 00 00 32 00 02 28 00 05 01 00 00 96 00 02 10 00];
						qcom,mdss-dsi-on-command-state = "dsi_lp_mode";
						qcom,mdss-dsi-off-command-state = "dsi_hs_mode";
						qcom,video-to-cmd-mode-post-switch-commands = [15 01 00 00 00 00 02 b0 00 29 01 00 00 00 00 05 b7 40 00 00 00];
						qcom,video-to-cmd-mode-post-switch-commands-state = "dsi_lp_mode";
					};

					timing@1 {
						qcom,mdss-dsi-video-mode;
						qcom,mdss-dsi-panel-width = <0x438>;
						qcom,mdss-dsi-panel-height = <0x8e8>;
						qcom,mdss-dsi-h-front-porch = <0x28>;
						qcom,mdss-dsi-h-back-porch = <0x28>;
						qcom,mdss-dsi-h-pulse-width = <0x14>;
						qcom,mdss-dsi-h-sync-skew = <0x00>;
						qcom,mdss-dsi-v-back-porch = <0x06>;
						qcom,mdss-dsi-v-front-porch = <0x0a>;
						qcom,mdss-dsi-v-pulse-width = <0x02>;
						qcom,mdss-dsi-panel-framerate = <0x3c>;
						qcom,mdss-dsi-on-command = [29 01 00 00 00 00 02 b0 00 29 01 00 00 00 00 0d b6 30 6b 00 06 03 0a 13 1a 6c 18 19 02 29 01 00 00 00 00 05 b7 51 00 00 00 29 01 00 00 00 00 08 b8 57 3d 19 be 1e 0a 0a 29 01 00 00 00 00 08 b9 6f 3d 28 be 3c 14 0a 29 01 00 00 00 00 08 ba b5 33 41 be 64 23 0a 29 01 00 00 00 00 0c bb 44 26 c3 1f 19 06 03 c0 00 00 10 29 01 00 00 00 00 0c bc 32 4c c3 52 32 1f 03 f2 00 00 13 29 01 00 00 00 00 0c bd 24 68 c3 aa 3f 32 03 ff 00 00 25 29 01 00 00 00 00 0d be 00 00 00 00 00 00 00 00 00 00 00 00 29 01 00 00 00 00 0d c0 00 dc 00 dc 04 08 e8 00 04 00 03 78 29 01 00 00 00 00 24 c1 30 00 00 11 11 00 00 00 22 00 05 20 fa 00 08 00 00 00 00 00 00 00 00 00 00 00 00 00 00 00 00 00 00 00 00 29 01 00 00 00 00 79 c2 06 e0 6e 01 03 00 02 00 00 00 00 00 00 00 00 00 00 00 00 00 00 00 00 00 00 00 00 00 00 00 00 00 00 00 00 00 00 00 00 00 00 11 00 00 00 00 04 a0 c9 00 00 00 00 00 00 48 eb 00 00 01 00 00 00 11 00 00 00 00 00 00 00 00 00 00 00 00 00 00 00 00 00 00 00 00 11 00 00 00 00 00 00 dc 00 00 00 00 04 00 08 ef 00 00 00 00 00 11 00 00 00 00 00 00 00 00 00 00 00 00 00 00 29 01 00 00 00 00 6d c3 00 00 00 00 00 00 00 00 00 00 00 00 00 00 00 00 00 00 00 00 00 00 00 00 00 00 00 00 00 00 00 00 00 00 00 00 00 00 00 00 00 00 00 00 00 00 00 00 00 00 00 00 00 00 00 00 00 00 00 00 00 00 aa aa aa 00 00 00 00 00 00 00 00 00 00 00 00 00 00 00 00 00 00 00 00 00 00 00 00 00 00 00 00 00 00 00 00 00 00 00 00 00 00 00 00 00 00 00 29 01 00 00 00 00 62 c4 00 4c 00 3f 00 83 00 00 87 86 85 84 00 00 00 00 00 61 5d 5f 00 5e 60 62 00 00 00 02 00 83 00 00 87 86 85 84 00 00 00 00 00 61 5d 5f 00 5e 60 62 ff ff ff ff ff ff 00 0f 0e 00 0f 0e 00 00 00 00 00 00 00 0f ee 00 0f ee 00 00 e0 00 00 e0 0e 00 00 00 0e 00 00 00 00 00 ff 57 00 00 00 00 00 00 00 29 01 00 00 00 00 06 c5 08 00 00 00 00 29 01 00 00 00 00 3a c6 02 0a 08 fc ff ff ff 00 00 13 01 f0 0c 06 01 43 43 43 00 00 00 01 77 09 28 28 06 01 43 43 43 00 00 00 01 61 00 00 00 1c 01 00 00 00 00 00 00 00 00 00 00 00 00 20 20 00 00 29 01 00 00 00 00 4d c7 00 00 00 e0 01 e9 02 7e 02 05 02 90 02 f6 02 40 02 5c 02 77 02 c8 02 1b 02 5b 02 bd 02 27 02 c3 03 54 03 d8 03 ff 00 00 00 e0 01 e9 02 7e 02 05 02 90 02 f6 02 40 02 5c 02 77 02 c8 02 1b 02 5b 02 bd 02 27 02 c3 03 54 03 d8 03 ff 29 01 00 00 00 00 42 c8 41 00 ff fa 00 ff 00 00 fe f6 fe e9 00 00 ff f7 fb e1 00 00 00 00 00 ff 00 00 ff fa 00 ff 00 fe f6 fe e9 00 ff f7 fb e1 00 00 00 00 ff 00 ff fa 00 ff 00 fe f6 fe e9 00 ff f7 fb e1 00 00 00 00 ff 29 01 00 00 00 00 19 c9 00 ff fa 00 ff 00 00 fe f6 fe e9 00 00 ff f7 fb e1 00 00 00 00 00 ff 00 29 01 00 00 00 00 42 ca 1c fc fc fc 00 00 00 00 00 00 00 00 00 00 00 00 00 00 00 00 00 00 00 00 00 00 00 00 00 00 00 00 00 00 00 00 00 00 00 00 00 00 00 00 00 00 00 00 00 00 00 00 00 00 00 00 00 00 00 00 00 00 00 00 00 29 01 00 00 00 00 0b cc 00 00 4d 8b 55 4d 8b aa 4d 8b 29 01 00 00 00 00 02 cd 00 29 01 00 00 00 00 24 ce 5d 40 49 53 59 5e 63 68 6e 74 7e 8a 98 a8 bb d0 e7 ff 04 00 04 04 42 04 69 5a 40 11 f4 00 00 84 fa 00 00 29 01 00 00 00 00 07 cf 00 00 80 46 61 00 29 01 00 00 00 00 12 d0 f6 95 11 b1 55 cf 00 f6 d3 11 f0 01 12 cf 02 20 11 29 01 00 00 00 00 23 d1 d3 d3 33 33 07 03 3b 33 77 37 77 37 35 77 07 77 f7 33 73 07 33 33 03 33 1b 03 32 3d 0a 30 13 13 20 00 29 01 00 00 00 00 05 d2 00 00 07 00 29 01 00 00 00 00 9a d3 03 00 00 00 00 00 00 0f 00 57 00 00 32 00 00 1a 70 01 19 80 01 01 f0 02 00 e0 06 ff f7 ff ff f7 ff ff f7 ff ff f7 ff ff f7 ff ff f7 ff ff f7 ff ff f7 ff ff f7 ff ff f7 ff ff f7 ff ff f7 ff ff f7 ff ff f7 ff ff f7 ff ff f7 ff ff f7 ff ff f7 ff ff f7 ff ff f7 ff ff f7 ff ff f7 ff ff f7 ff ff f7 ff ff f7 ff ff f7 ff ff f7 ff ff f7 ff ff f7 ff ff f7 ff ff f7 ff ff f7 ff ff f7 ff ff f7 ff ff f7 ff ff f7 ff ff f7 ff ff f7 ff ff f7 ff ff f7 ff ff f7 ff ff f7 ff 29 01 00 00 00 00 05 e5 03 00 00 00 29 01 00 00 00 00 09 d5 02 42 02 42 02 dc 02 dc 29 01 00 00 00 00 02 d6 c0 29 01 00 00 00 00 32 d7 21 10 52 52 00 b6 04 fd 00 b6 04 fd 00 82 80 83 84 85 83 80 84 45 85 85 85 87 04 06 02 04 04 07 10 0c 0b 0a 0a 07 06 00 08 00 00 00 00 00 00 00 00 29 01 00 00 00 00 05 dd 30 06 23 65 29 01 00 00 00 00 0d de 00 00 00 0f ff 00 00 00 00 00 00 10 29 01 00 00 00 00 02 e3 ff 29 01 00 00 00 00 07 e6 00 00 00 00 00 00 29 01 00 00 00 00 0b e7 50 04 00 00 00 00 00 00 00 00 29 01 00 00 00 00 05 e8 00 01 23 00 29 01 00 00 00 00 1e ea 01 02 47 80 47 00 00 00 05 00 12 60 02 47 80 47 00 00 00 00 13 60 00 11 00 30 10 21 02 29 01 00 00 00 00 08 eb 00 00 00 00 01 00 11 29 01 00 00 00 00 04 ec 00 00 00 29 01 00 00 00 00 21 ed 01 01 02 02 02 02 00 00 00 00 00 00 0a 00 00 00 00 10 00 18 00 18 00 b0 00 00 00 00 00 da 10 00 29 01 00 00 00 00 61 ee 03 0f 00 00 00 00 40 1f 00 00 0f f2 3f 00 00 00 00 00 00 00 00 00 00 00 00 00 00 00 10 01 00 09 01 8c d8 ef 00 00 00 00 00 00 00 00 00 00 00 00 00 00 00 00 00 00 50 1f 00 00 00 00 00 00 00 00 00 00 00 00 00 00 00 00 00 00 00 00 00 00 00 00 00 00 00 00 00 00 00 00 00 00 00 00 00 00 00 00 29 01 00 00 00 00 8c ef 00 70 4a 08 d0 00 00 00 00 3c 3c 3c 00 00 00 00 00 00 00 00 00 00 00 00 00 00 00 00 70 4a 08 d0 00 00 00 00 3c 3c 3c 00 00 00 00 00 00 00 00 00 00 00 00 00 00 00 00 00 00 00 00 00 00 00 00 00 00 00 00 00 00 00 00 00 00 00 00 00 00 00 00 00 00 00 00 00 00 00 00 00 00 00 00 00 03 08 ec 50 10 00 10 00 0a 0a 00 00 00 00 10 0f 00 03 51 00 50 00 00 00 00 00 00 00 00 00 00 00 00 00 00 00 00 00 00 00 00 00 00 00 03 08 ec 29 01 00 00 00 00 02 b0 03 29 01 00 00 00 00 02 b0 04 29 01 00 00 00 00 02 d6 00 39 01 00 00 00 00 03 51 ff f0 39 01 00 00 00 00 02 53 0c 39 01 00 00 00 00 02 55 00 39 01 00 00 00 00 02 35 00 39 01 00 00 00 00 05 2a 00 00 04 37 39 01 00 00 00 00 05 2b 00 00 08 e7 05 01 00 00 ff 00 02 29 00 05 01 00 00 ff 00 02 11 00];
						qcom,mdss-dsi-off-command = [05 01 00 00 32 00 02 28 00 05 01 00 00 96 00 02 10 00];
						qcom,mdss-dsi-on-command-state = "dsi_lp_mode";
						qcom,mdss-dsi-off-command-state = "dsi_hs_mode";
						qcom,cmd-to-video-mode-post-switch-commands = [15 01 00 00 00 00 02 b0 00 29 01 00 00 00 00 05 b7 51 00 00 00];
						qcom,cmd-to-video-mode-post-switch-commands-state = "dsi_lp_mode";
					};
				};
			};
		};
	};

	fragment@7 {
		target = <0xffffffff>;

		__overlay__ {

			qcom,mdss_dsi_td4330_truly_v2_video {
				qcom,mdss-dsi-panel-name = "td4330 v2 video mode dsi truly panel";
				qcom,mdss-dsi-panel-type = "dsi_video_mode";
				qcom,dsi-ctrl-num = <0x00>;
				qcom,dsi-phy-num = <0x00>;
				qcom,mdss-dsi-panel-mode-switch;
				qcom,mdss-dsi-virtual-channel-id = <0x00>;
				qcom,mdss-dsi-stream = <0x00>;
				qcom,mdss-dsi-h-left-border = <0x00>;
				qcom,mdss-dsi-h-right-border = <0x00>;
				qcom,mdss-dsi-v-top-border = <0x00>;
				qcom,mdss-dsi-v-bottom-border = <0x00>;
				qcom,mdss-dsi-bpp = <0x18>;
				qcom,mdss-dsi-color-order = "rgb_swap_rgb";
				qcom,mdss-dsi-underflow-color = <0xff>;
				qcom,mdss-dsi-border-color = <0x00>;
				qcom,mdss-dsi-h-sync-pulse = <0x00>;
				qcom,mdss-dsi-traffic-mode = "non_burst_sync_event";
				qcom,mdss-dsi-lane-map = "lane_map_0123";
				qcom,mdss-dsi-bllp-eof-power-mode;
				qcom,mdss-dsi-bllp-power-mode;
				qcom,mdss-dsi-tx-eot-append;
				qcom,mdss-dsi-lane-0-state;
				qcom,mdss-dsi-lane-1-state;
				qcom,mdss-dsi-lane-2-state;
				qcom,mdss-dsi-lane-3-state;
				qcom,mdss-dsi-dma-trigger = "trigger_sw";
				qcom,mdss-dsi-mdp-trigger = "none";
				qcom,mdss-dsi-lp11-init;
				qcom,mdss-dsi-bl-pmic-control-type = "bl_ctrl_wled";
				qcom,mdss-dsi-bl-min-level = <0x01>;
				qcom,mdss-dsi-bl-max-level = <0xfff>;
				qcom,mdss-dsi-reset-sequence = <0x01 0x0a 0x00 0x0a 0x01 0x0a>;
				qcom,mdss-pan-physical-width-dimension = <0x41>;
				qcom,mdss-pan-physical-height-dimension = <0x81>;
				qcom,mdss-dsi-te-pin-select = <0x01>;
				qcom,mdss-dsi-wr-mem-start = <0x2c>;
				qcom,mdss-dsi-wr-mem-continue = <0x3c>;
				qcom,mdss-dsi-te-dcs-command = <0x01>;
				qcom,mdss-dsi-te-check-enable;
				qcom,mdss-dsi-te-using-te-pin;
				phandle = <0x2b>;

				qcom,mdss-dsi-display-timings {

					timing@0 {
						qcom,mdss-dsi-video-mode;
						qcom,mdss-dsi-panel-width = <0x438>;
						qcom,mdss-dsi-panel-height = <0x8e8>;
						qcom,mdss-dsi-h-front-porch = <0x28>;
						qcom,mdss-dsi-h-back-porch = <0x28>;
						qcom,mdss-dsi-h-pulse-width = <0x14>;
						qcom,mdss-dsi-h-sync-skew = <0x00>;
						qcom,mdss-dsi-v-back-porch = <0x06>;
						qcom,mdss-dsi-v-front-porch = <0x0a>;
						qcom,mdss-dsi-v-pulse-width = <0x02>;
						qcom,mdss-dsi-panel-framerate = <0x3c>;
						qcom,mdss-dsi-on-command = [29 01 00 00 00 00 02 b0 00 29 01 00 00 00 00 0d b6 30 6b 00 06 03 0a 13 1a 6c 18 19 02 29 01 00 00 00 00 05 b7 51 00 00 00 29 01 00 00 00 00 08 b8 57 3d 19 be 1e 0a 0a 29 01 00 00 00 00 08 b9 6f 3d 28 be 3c 14 0a 29 01 00 00 00 00 08 ba b5 33 41 be 64 23 0a 29 01 00 00 00 00 0c bb 44 26 c3 1f 19 06 03 c0 00 00 10 29 01 00 00 00 00 0c bc 32 4c c3 52 32 1f 03 f2 00 00 13 29 01 00 00 00 00 0c bd 24 68 c3 aa 3f 32 03 ff 00 00 25 29 01 00 00 00 00 0d be 00 00 00 00 00 00 00 00 00 00 00 00 29 01 00 00 00 00 0d c0 00 dc 00 dc 04 08 e8 00 04 00 03 78 29 01 00 00 00 00 24 c1 30 00 00 11 11 00 00 00 22 00 05 20 fa 00 08 00 00 00 00 00 00 00 00 00 00 00 00 00 00 00 00 00 00 00 00 29 01 00 00 00 00 79 c2 06 e0 6e 01 03 00 02 00 00 00 00 00 00 00 00 00 00 00 00 00 00 00 00 00 00 00 00 00 00 00 00 00 00 00 00 00 00 00 00 00 00 11 00 00 00 00 04 a0 c9 00 00 00 00 00 00 48 eb 00 00 01 00 00 00 11 00 00 00 00 00 00 00 00 00 00 00 00 00 00 00 00 00 00 00 00 11 00 00 00 00 00 00 dc 00 00 00 00 04 00 08 ef 00 00 00 00 00 11 00 00 00 00 00 00 00 00 00 00 00 00 00 00 29 01 00 00 00 00 6d c3 00 00 00 00 00 00 00 00 00 00 00 00 00 00 00 00 00 00 00 00 00 00 00 00 00 00 00 00 00 00 00 00 00 00 00 00 00 00 00 00 00 00 00 00 00 00 00 00 00 00 00 00 00 00 00 00 00 00 00 00 00 00 aa aa aa 00 00 00 00 00 00 00 00 00 00 00 00 00 00 00 00 00 00 00 00 00 00 00 00 00 00 00 00 00 00 00 00 00 00 00 00 00 00 00 00 00 00 00 29 01 00 00 00 00 62 c4 00 4c 00 3f 00 83 00 00 87 86 85 84 00 00 00 00 00 61 5d 5f 00 5e 60 62 00 00 00 02 00 83 00 00 87 86 85 84 00 00 00 00 00 61 5d 5f 00 5e 60 62 ff ff ff ff ff ff 00 0f 0e 00 0f 0e 00 00 00 00 00 00 00 0f ee 00 0f ee 00 00 e0 00 00 e0 0e 00 00 00 0e 00 00 00 00 00 ff 57 00 00 00 00 00 00 00 29 01 00 00 00 00 06 c5 08 00 00 00 00 29 01 00 00 00 00 3a c6 02 0a 08 fc ff ff ff 00 00 13 01 f0 0c 06 01 43 43 43 00 00 00 01 77 09 28 28 06 01 43 43 43 00 00 00 01 61 00 00 00 1c 01 00 00 00 00 00 00 00 00 00 00 00 00 20 20 00 00 29 01 00 00 00 00 4d c7 00 00 00 e0 01 e9 02 7e 02 05 02 90 02 f6 02 40 02 5c 02 77 02 c8 02 1b 02 5b 02 bd 02 27 02 c3 03 54 03 d8 03 ff 00 00 00 e0 01 e9 02 7e 02 05 02 90 02 f6 02 40 02 5c 02 77 02 c8 02 1b 02 5b 02 bd 02 27 02 c3 03 54 03 d8 03 ff 29 01 00 00 00 00 42 c8 41 00 ff fa 00 ff 00 00 fe f6 fe e9 00 00 ff f7 fb e1 00 00 00 00 00 ff 00 00 ff fa 00 ff 00 fe f6 fe e9 00 ff f7 fb e1 00 00 00 00 ff 00 ff fa 00 ff 00 fe f6 fe e9 00 ff f7 fb e1 00 00 00 00 ff 29 01 00 00 00 00 19 c9 00 ff fa 00 ff 00 00 fe f6 fe e9 00 00 ff f7 fb e1 00 00 00 00 00 ff 00 29 01 00 00 00 00 42 ca 1c fc fc fc 00 00 00 00 00 00 00 00 00 00 00 00 00 00 00 00 00 00 00 00 00 00 00 00 00 00 00 00 00 00 00 00 00 00 00 00 00 00 00 00 00 00 00 00 00 00 00 00 00 00 00 00 00 00 00 00 00 00 00 00 00 29 01 00 00 00 00 0b cc 00 00 4d 8b 55 4d 8b aa 4d 8b 29 01 00 00 00 00 02 cd 00 29 01 00 00 00 00 24 ce 5d 40 49 53 59 5e 63 68 6e 74 7e 8a 98 a8 bb d0 e7 ff 04 00 04 04 42 04 69 5a 40 11 f4 00 00 84 fa 00 00 29 01 00 00 00 00 07 cf 00 00 80 46 61 00 29 01 00 00 00 00 12 d0 f6 95 11 b1 55 cf 00 f6 d3 11 f0 01 12 cf 02 20 11 29 01 00 00 00 00 23 d1 d3 d3 33 33 07 03 3b 33 77 37 77 37 35 77 07 77 f7 33 73 07 33 33 03 33 1b 03 32 3d 0a 30 13 13 20 00 29 01 00 00 00 00 05 d2 00 00 07 00 29 01 00 00 00 00 9a d3 03 00 00 00 00 00 00 0f 00 57 00 00 32 00 00 1a 70 01 19 80 01 01 f0 02 00 e0 06 ff f7 ff ff f7 ff ff f7 ff ff f7 ff ff f7 ff ff f7 ff ff f7 ff ff f7 ff ff f7 ff ff f7 ff ff f7 ff ff f7 ff ff f7 ff ff f7 ff ff f7 ff ff f7 ff ff f7 ff ff f7 ff ff f7 ff ff f7 ff ff f7 ff ff f7 ff ff f7 ff ff f7 ff ff f7 ff ff f7 ff ff f7 ff ff f7 ff ff f7 ff ff f7 ff ff f7 ff ff f7 ff ff f7 ff ff f7 ff ff f7 ff ff f7 ff ff f7 ff ff f7 ff ff f7 ff ff f7 ff ff f7 ff ff f7 ff 29 01 00 00 00 00 05 e5 03 00 00 00 29 01 00 00 00 00 09 d5 02 42 02 42 02 dc 02 dc 29 01 00 00 00 00 02 d6 c0 29 01 00 00 00 00 32 d7 21 10 52 52 00 b6 04 fd 00 b6 04 fd 00 82 80 83 84 85 83 80 84 45 85 85 85 87 04 06 02 04 04 07 10 0c 0b 0a 0a 07 06 00 08 00 00 00 00 00 00 00 00 29 01 00 00 00 00 05 dd 30 06 23 65 29 01 00 00 00 00 0d de 00 00 00 0f ff 00 00 00 00 00 00 10 29 01 00 00 00 00 02 e3 ff 29 01 00 00 00 00 07 e6 00 00 00 00 00 00 29 01 00 00 00 00 0b e7 50 04 00 00 00 00 00 00 00 00 29 01 00 00 00 00 05 e8 00 01 23 00 29 01 00 00 00 00 1e ea 01 02 47 80 47 00 00 00 05 00 12 60 02 47 80 47 00 00 00 00 13 60 00 11 00 30 10 21 02 29 01 00 00 00 00 08 eb 00 00 00 00 01 00 11 29 01 00 00 00 00 04 ec 00 00 00 29 01 00 00 00 00 21 ed 01 01 02 02 02 02 00 00 00 00 00 00 0a 00 00 00 00 10 00 18 00 18 00 b0 00 00 00 00 00 da 10 00 29 01 00 00 00 00 61 ee 03 0f 00 00 00 00 40 1f 00 00 0f f2 3f 00 00 00 00 00 00 00 00 00 00 00 00 00 00 00 10 01 00 09 01 8c d8 ef 00 00 00 00 00 00 00 00 00 00 00 00 00 00 00 00 00 00 50 1f 00 00 00 00 00 00 00 00 00 00 00 00 00 00 00 00 00 00 00 00 00 00 00 00 00 00 00 00 00 00 00 00 00 00 00 00 00 00 00 00 29 01 00 00 00 00 8c ef 00 70 4a 08 d0 00 00 00 00 3c 3c 3c 00 00 00 00 00 00 00 00 00 00 00 00 00 00 00 00 70 4a 08 d0 00 00 00 00 3c 3c 3c 00 00 00 00 00 00 00 00 00 00 00 00 00 00 00 00 00 00 00 00 00 00 00 00 00 00 00 00 00 00 00 00 00 00 00 00 00 00 00 00 00 00 00 00 00 00 00 00 00 00 00 00 00 03 08 ec 50 10 00 10 00 0a 0a 00 00 00 00 10 0f 00 03 51 00 50 00 00 00 00 00 00 00 00 00 00 00 00 00 00 00 00 00 00 00 00 00 00 00 03 08 ec 29 01 00 00 00 00 02 b0 03 29 01 00 00 00 00 02 b0 04 29 01 00 00 00 00 02 d6 00 39 01 00 00 00 00 03 51 ff f0 39 01 00 00 00 00 02 53 0c 39 01 00 00 00 00 02 55 00 39 01 00 00 00 00 02 35 00 39 01 00 00 00 00 05 2a 00 00 04 37 39 01 00 00 00 00 05 2b 00 00 08 e7 05 01 00 00 ff 00 02 29 00 05 01 00 00 ff 00 02 11 00];
						qcom,mdss-dsi-off-command = [05 01 00 00 32 00 02 28 00 05 01 00 00 96 00 02 10 00];
						qcom,mdss-dsi-on-command-state = "dsi_lp_mode";
						qcom,mdss-dsi-off-command-state = "dsi_hs_mode";
						qcom,cmd-to-video-mode-post-switch-commands = [15 01 00 00 00 00 02 b0 00 29 01 00 00 00 00 05 b7 51 00 00 00];
						qcom,cmd-to-video-mode-post-switch-commands-state = "dsi_lp_mode";
					};

					timing@1 {
						qcom,mdss-dsi-cmd-mode;
						qcom,mdss-dsi-panel-width = <0x438>;
						qcom,mdss-dsi-panel-height = <0x8e8>;
						qcom,mdss-dsi-h-front-porch = <0x50>;
						qcom,mdss-dsi-h-back-porch = <0x50>;
						qcom,mdss-dsi-h-pulse-width = <0x14>;
						qcom,mdss-dsi-h-sync-skew = <0x00>;
						qcom,mdss-dsi-v-back-porch = <0x0d>;
						qcom,mdss-dsi-v-front-porch = <0x10>;
						qcom,mdss-dsi-v-pulse-width = <0x02>;
						qcom,mdss-dsi-panel-framerate = <0x3c>;
						qcom,mdss-dsi-panel-jitter = <0x04 0x01>;
						qcom,mdss-dsi-on-command = [29 01 00 00 00 00 02 b0 00 29 01 00 00 00 00 0d b6 30 6b 00 06 03 0a 13 1a 6c 18 19 02 29 01 00 00 00 00 05 b7 40 00 00 00 29 01 00 00 00 00 08 b8 57 3d 19 be 1e 0a 0a 29 01 00 00 00 00 08 b9 6f 3d 28 be 3c 14 0a 29 01 00 00 00 00 08 ba b5 33 41 be 64 23 0a 29 01 00 00 00 00 0c bb 44 26 c3 1f 19 06 03 c0 00 00 10 29 01 00 00 00 00 0c bc 32 4c c3 52 32 1f 03 f2 00 00 13 29 01 00 00 00 00 0c bd 24 68 c3 aa 3f 32 03 ff 00 00 25 29 01 00 00 00 00 0d be 00 00 00 00 00 00 00 00 00 00 00 00 29 01 00 00 00 00 0d c0 00 dc 00 dc 04 08 e8 00 04 00 03 78 29 01 00 00 00 00 24 c1 30 00 00 11 11 00 00 00 22 00 05 20 fa 00 08 00 00 00 00 00 00 00 00 00 00 00 00 00 00 00 00 00 00 00 00 29 01 00 00 00 00 79 c2 06 e0 6e 01 03 00 02 00 00 00 00 00 00 00 00 00 00 00 00 00 00 00 00 00 00 00 00 00 00 00 00 00 00 00 00 00 00 00 00 00 00 11 00 00 00 00 04 a0 c9 00 00 00 00 00 00 48 eb 00 00 01 00 00 00 11 00 00 00 00 00 00 00 00 00 00 00 00 00 00 00 00 00 00 00 00 11 00 00 00 00 00 00 dc 00 00 00 00 04 00 08 ef 00 00 00 00 00 11 00 00 00 00 00 00 00 00 00 00 00 00 00 00 29 01 00 00 00 00 6d c3 00 00 00 00 00 00 00 00 00 00 00 00 00 00 00 00 00 00 00 00 00 00 00 00 00 00 00 00 00 00 00 00 00 00 00 00 00 00 00 00 00 00 00 00 00 00 00 00 00 00 00 00 00 00 00 00 00 00 00 00 00 00 aa aa aa 00 00 00 00 00 00 00 00 00 00 00 00 00 00 00 00 00 00 00 00 00 00 00 00 00 00 00 00 00 00 00 00 00 00 00 00 00 00 00 00 00 00 00 29 01 00 00 00 00 62 c4 00 4c 00 3f 00 83 00 00 87 86 85 84 00 00 00 00 00 61 5d 5f 00 5e 60 62 00 00 00 02 00 83 00 00 87 86 85 84 00 00 00 00 00 61 5d 5f 00 5e 60 62 ff ff ff ff ff ff 00 0f 0e 00 0f 0e 00 00 00 00 00 00 00 0f ee 00 0f ee 00 00 e0 00 00 e0 0e 00 00 00 0e 00 00 00 00 00 ff 57 00 00 00 00 00 00 00 29 01 00 00 00 00 06 c5 08 00 00 00 00 29 01 00 00 00 00 3a c6 02 0a 08 fc ff ff ff 00 00 13 01 f0 0c 06 01 43 43 43 00 00 00 01 77 09 28 28 06 01 43 43 43 00 00 00 01 61 00 00 00 1c 01 00 00 00 00 00 00 00 00 00 00 00 00 20 20 00 00 29 01 00 00 00 00 4d c7 00 00 00 e0 01 e9 02 7e 02 05 02 90 02 f6 02 40 02 5c 02 77 02 c8 02 1b 02 5b 02 bd 02 27 02 c3 03 54 03 d8 03 ff 00 00 00 e0 01 e9 02 7e 02 05 02 90 02 f6 02 40 02 5c 02 77 02 c8 02 1b 02 5b 02 bd 02 27 02 c3 03 54 03 d8 03 ff 29 01 00 00 00 00 42 c8 41 00 ff fa 00 ff 00 00 fe f6 fe e9 00 00 ff f7 fb e1 00 00 00 00 00 ff 00 00 ff fa 00 ff 00 fe f6 fe e9 00 ff f7 fb e1 00 00 00 00 ff 00 ff fa 00 ff 00 fe f6 fe e9 00 ff f7 fb e1 00 00 00 00 ff 29 01 00 00 00 00 19 c9 00 ff fa 00 ff 00 00 fe f6 fe e9 00 00 ff f7 fb e1 00 00 00 00 00 ff 00 29 01 00 00 00 00 42 ca 1c fc fc fc 00 00 00 00 00 00 00 00 00 00 00 00 00 00 00 00 00 00 00 00 00 00 00 00 00 00 00 00 00 00 00 00 00 00 00 00 00 00 00 00 00 00 00 00 00 00 00 00 00 00 00 00 00 00 00 00 00 00 00 00 00 29 01 00 00 00 00 0b cc 00 00 4d 8b 55 4d 8b aa 4d 8b 29 01 00 00 00 00 02 cd 00 29 01 00 00 00 00 24 ce 5d 40 49 53 59 5e 63 68 6e 74 7e 8a 98 a8 bb d0 e7 ff 04 00 04 04 42 04 69 5a 40 11 f4 00 00 84 fa 00 00 29 01 00 00 00 00 07 cf 00 00 80 46 61 00 29 01 00 00 00 00 12 d0 f6 95 11 b1 55 cf 00 f6 d3 11 f0 01 12 cf 02 20 11 29 01 00 00 00 00 23 d1 d3 d3 33 33 07 03 3b 33 77 37 77 37 35 77 07 77 f7 33 73 07 33 33 03 33 1b 03 32 3d 0a 30 13 13 20 00 29 01 00 00 00 00 05 d2 00 00 07 00 29 01 00 00 00 00 9a d3 03 00 00 00 00 00 00 0f 00 57 00 00 32 00 00 1a 70 01 19 80 01 01 f0 02 00 e0 06 ff f7 ff ff f7 ff ff f7 ff ff f7 ff ff f7 ff ff f7 ff ff f7 ff ff f7 ff ff f7 ff ff f7 ff ff f7 ff ff f7 ff ff f7 ff ff f7 ff ff f7 ff ff f7 ff ff f7 ff ff f7 ff ff f7 ff ff f7 ff ff f7 ff ff f7 ff ff f7 ff ff f7 ff ff f7 ff ff f7 ff ff f7 ff ff f7 ff ff f7 ff ff f7 ff ff f7 ff ff f7 ff ff f7 ff ff f7 ff ff f7 ff ff f7 ff ff f7 ff ff f7 ff ff f7 ff ff f7 ff ff f7 ff ff f7 ff 29 01 00 00 00 00 05 e5 03 00 00 00 29 01 00 00 00 00 09 d5 02 42 02 42 02 dc 02 dc 29 01 00 00 00 00 02 d6 c0 29 01 00 00 00 00 32 d7 21 10 52 52 00 b6 04 fd 00 b6 04 fd 00 82 80 83 84 85 83 80 84 45 85 85 85 87 04 06 02 04 04 07 10 0c 0b 0a 0a 07 06 00 08 00 00 00 00 00 00 00 00 29 01 00 00 00 00 05 dd 30 06 23 65 29 01 00 00 00 00 0d de 00 00 00 0f ff 00 00 00 00 00 00 10 29 01 00 00 00 00 02 e3 ff 29 01 00 00 00 00 07 e6 00 00 00 00 00 00 29 01 00 00 00 00 0b e7 50 04 00 00 00 00 00 00 00 00 29 01 00 00 00 00 05 e8 00 01 23 00 29 01 00 00 00 00 1e ea 01 02 47 80 47 00 00 00 05 00 13 60 02 47 80 47 00 00 00 00 13 60 00 11 00 30 10 21 02 29 01 00 00 00 00 08 eb 00 00 00 00 01 00 11 29 01 00 00 00 00 04 ec 00 00 00 29 01 00 00 00 00 21 ed 01 01 02 02 02 02 00 00 00 00 00 00 0a 00 00 00 00 10 00 18 00 18 00 b0 00 00 00 00 00 da 10 00 29 01 00 00 00 00 61 ee 03 0f 00 00 00 00 40 1f 00 00 0f f2 3f 00 00 00 00 00 00 00 00 00 00 00 00 00 00 00 10 01 00 09 01 8c d8 ef 00 00 00 00 00 00 00 00 00 00 00 00 00 00 00 00 00 00 50 1f 00 00 00 00 00 00 00 00 00 00 00 00 00 00 00 00 00 00 00 00 00 00 00 00 00 00 00 00 00 00 00 00 00 00 00 00 00 00 00 00 29 01 00 00 00 00 8c ef 00 70 4a 08 d0 00 00 00 00 3c 3c 3c 00 00 00 00 00 00 00 00 00 00 00 00 00 00 00 00 70 4a 08 d0 00 00 00 00 3c 3c 3c 00 00 00 00 00 00 00 00 00 00 00 00 00 00 00 00 00 00 00 00 00 00 00 00 00 00 00 00 00 00 00 00 00 00 00 00 00 00 00 00 00 00 00 00 00 00 00 00 00 00 00 00 00 03 08 ec 50 10 00 10 00 0a 0a 00 00 00 00 10 0f 00 03 51 00 50 00 00 00 00 00 00 00 00 00 00 00 00 00 00 00 00 00 00 00 00 00 00 00 03 08 ec 29 01 00 00 00 00 02 b0 03 29 01 00 00 00 00 02 b0 04 29 01 00 00 00 00 02 d6 00 39 01 00 00 00 00 03 51 ff f0 39 01 00 00 00 00 02 53 0c 39 01 00 00 00 00 02 55 00 39 01 00 00 00 00 02 35 00 39 01 00 00 00 00 05 2a 00 00 04 37 39 01 00 00 00 00 05 2b 00 00 08 e7 05 01 00 00 ff 00 02 29 00 05 01 00 00 ff 00 02 11 00];
						qcom,mdss-dsi-off-command = [05 01 00 00 32 00 02 28 00 05 01 00 00 96 00 02 10 00];
						qcom,mdss-dsi-on-command-state = "dsi_lp_mode";
						qcom,mdss-dsi-off-command-state = "dsi_hs_mode";
						qcom,video-to-cmd-mode-post-switch-commands = [15 01 00 00 00 00 02 b0 00 29 01 00 00 00 00 05 b7 40 00 00 00];
						qcom,video-to-cmd-mode-post-switch-commands-state = "dsi_lp_mode";
					};
				};
			};
		};
	};

	fragment@8 {
		target = <0xffffffff>;

		__overlay__ {

			qcom,mdss_dsi_panel_k7_38_0c_0a_fhdp_video {
				qcom,mdss-dsi-panel-name = "k7 38 0c 0a video mode fhdp dsi panel";
				qcom,mdss-dsi-panel-model = "xiaomi 38 0c 0a VIDEO PANEL";
				qcom,mdss-dsi-panel-type = "dsi_video_mode";
				qcom,dsi-ctrl-num = <0x00>;
				qcom,dsi-phy-num = <0x00>;
				qcom,mdss-dsi-panel-physical-type = "oled";
				qcom,mdss-dsi-virtual-channel-id = <0x00>;
				qcom,mdss-dsi-stream = <0x00>;
				qcom,mdss-dsi-h-left-border = <0x00>;
				qcom,mdss-dsi-h-right-border = <0x00>;
				qcom,mdss-dsi-v-top-border = <0x00>;
				qcom,mdss-dsi-v-bottom-border = <0x00>;
				qcom,mdss-dsi-bpp = <0x18>;
				qcom,mdss-dsi-color-order = "rgb_swap_rgb";
				qcom,mdss-dsi-underflow-color = <0xff>;
				qcom,mdss-dsi-border-color = <0x00>;
				qcom,mdss-dsi-h-sync-pulse = <0x00>;
				qcom,mdss-dsi-traffic-mode = "burst_mode";
				qcom,mdss-dsi-bllp-eof-power-mode;
				qcom,mdss-dsi-bllp-power-mode;
				qcom,mdss-dsi-tx-eot-append;
				qcom,mdss-dsi-lane-map = "lane_map_0123";
				qcom,mdss-dsi-lane-0-state;
				qcom,mdss-dsi-lane-1-state;
				qcom,mdss-dsi-lane-2-state;
				qcom,mdss-dsi-lane-3-state;
				qcom,mdss-dsi-dma-trigger = "trigger_sw";
				qcom,mdss-dsi-mdp-trigger = "none";
				qcom,mdss-dsi-lp11-init;
				qcom,mdss-dsi-bl-pmic-control-type = "bl_ctrl_dcs";
				qcom,mdss-dsi-bl-min-level = <0x01>;
				qcom,dispparam-enabled;
				qcom,mdss-dsi-bl-max-level = <0x7ff>;
				qcom,mdss-dsi-bl-inverted-dbv;
				qcom,mdss-brightness-max-level = <0x7ff>;
				qcom,mdss-dsi-reset-sequence = <0x01 0x0a 0x00 0x0a 0x01 0x0a>;
				qcom,mdss-pan-physical-width-dimension = <0x43>;
				qcom,mdss-pan-physical-height-dimension = <0x95>;
				qcom,mdss-dsi-te-pin-select = <0x01>;
				qcom,mdss-dsi-wr-mem-start = <0x2c>;
				qcom,mdss-dsi-wr-mem-continue = <0x3c>;
				qcom,mdss-dsi-te-dcs-command = <0x01>;
				qcom,mdss-dsi-te-check-enable;
				qcom,mdss-dsi-te-using-te-pin;
				qcom,mdss-dsi-pan-enable-dynamic-fps;
				qcom,mdss-dsi-pan-fps-update = "dfps_immediate_porch_mode_vfp";
				qcom,dsi-supported-dfps-list = <0x5a 0x3c>;
				qcom,esd-err-irq-gpio = <0xffffffff 0x63 0x2001>;
				qcom,esd-check-enabled;
				qcom,mdss-dsi-panel-status-check-mode = "reg_read";
				qcom,mdss-dsi-panel-status-command = <0x6010001 0x10a>;
				qcom,mdss-dsi-panel-status-command-state = "dsi_hs_mode";
				qcom,mdss-dsi-panel-status-value = <0x9d>;
				qcom,mdss-dsi-panel-on-check-value = <0x9d>;
				qcom,mdss-dsi-panel-status-read-length = <0x01>;
				qcom,platform-en-gpio = <0xffffffff 0x09 0x00>;
				qcom,dsi-select-clocks = "mux_byte_clk0\0mux_pixel_clk0\0src_byte_clk0\0src_pixel_clk0\0shadow_byte_clk0\0shadow_pixel_clk0";
				qcom,panel-supply-entries = <0x0d>;
				qcom,platform-reset-gpio = <0xffffffff 0x52 0x00>;
				phandle = <0x2c>;

				qcom,mdss-dsi-display-timings {

					timing@0 {
						qcom,mdss-dsi-panel-width = <0x438>;
						qcom,mdss-dsi-panel-height = <0x960>;
						qcom,mdss-dsi-panel-framerate = <0x5a>;
						qcom,mdss-dsi-h-pulse-width = <0x20>;
						qcom,mdss-dsi-h-back-porch = <0x78>;
						qcom,mdss-dsi-h-front-porch = <0x140>;
						qcom,mdss-dsi-h-sync-skew = <0x00>;
						qcom,mdss-dsi-v-pulse-width = <0x02>;
						qcom,mdss-dsi-v-back-porch = <0x0a>;
						qcom,mdss-dsi-v-front-porch = <0x14>;
						qcom,mdss-dsi-on-command = [05 01 00 00 14 00 01 11 39 01 00 00 00 00 05 f1 5a 5a 5a 5a 39 01 00 00 00 00 05 b0 00 2c e0 01 39 01 00 00 00 00 0c e0 00 03 95 07 85 03 39 05 6d 05 51 39 01 00 00 00 00 05 b0 00 41 e0 01 39 01 00 00 00 00 02 e0 03 39 01 00 00 00 00 05 f1 a5 a5 a5 a5 39 01 00 00 00 00 03 f1 5a 5a 39 01 00 00 00 00 03 b2 01 30 39 01 00 00 00 00 03 f1 a5 a5 39 01 00 00 00 00 05 f1 5a 5a 5a 5a 39 01 00 00 00 00 05 b0 00 08 ea 01 39 01 00 00 00 00 03 ea f4 89 39 01 00 00 00 00 05 b0 00 0a ea 01 39 01 00 00 00 00 04 ea 55 01 04 39 01 00 00 00 00 05 b0 00 0d ea 01 39 01 00 00 00 00 03 ea ff ff 39 01 00 00 00 00 05 b0 00 74 e1 01 39 01 00 00 00 00 02 e1 3f 39 01 00 00 00 00 05 b0 00 10 ea 01 39 01 00 00 00 00 02 ea 01 39 01 00 00 00 00 05 f1 a5 a5 a5 a5 39 01 00 00 00 00 05 f1 5a 5a 5a 5a 39 01 00 00 00 00 05 b0 00 32 f6 01 39 01 00 00 00 00 06 f6 24 00 19 00 00 39 01 00 00 00 00 05 f1 a5 a5 a5 a5 39 01 00 00 00 00 03 f1 5a 5a 39 01 00 00 00 00 04 b0 00 09 cd 39 01 00 00 00 00 04 cd 08 48 20 39 01 00 00 00 00 03 f1 a5 a5 39 01 00 00 00 00 02 9d 01 39 01 00 00 00 00 5a 9e 11 00 00 89 30 80 09 60 04 38 00 28 02 1c 02 1c 02 00 02 0e 00 20 03 dd 00 07 00 0c 02 77 02 8b 18 00 10 f0 03 0c 20 00 06 0b 0b 33 0e 1c 2a 38 46 54 62 69 70 77 79 7b 7d 7e 01 02 01 00 09 40 09 be 19 fc 19 fa 19 f8 1a 38 1a 78 1a b6 2a f6 2b 34 2b 74 3b 74 6b f4 00 39 01 00 00 00 00 03 f1 5a 5a 39 01 00 00 00 00 02 60 21 39 01 00 00 00 00 02 f7 07 39 01 00 00 00 00 03 f1 a5 a5 39 01 00 00 00 00 03 f1 5a 5a 39 01 00 00 00 00 05 b0 00 0d b2 01 39 01 00 00 00 00 02 b2 20 39 01 00 00 00 00 05 b0 00 0c b2 01 39 01 00 00 00 00 02 b2 30 39 01 00 00 00 00 03 f1 a5 a5 39 01 00 00 00 00 02 53 30 39 01 00 00 64 00 02 f7 07 05 01 00 00 00 00 01 29];
						qcom,mdss-dsi-off-command = <0x5010000 0xa000128 0x5010000 0x96000110>;
						qcom,mdss-dsi-dispparam-hbm-on-command = [39 01 00 00 00 00 02 53 f0 39 01 00 00 00 00 03 51 07 ff];
						qcom,mdss-dsi-dispparam-hbm-off-command = [39 01 00 00 00 00 02 53 30];
						qcom,mdss-dsi-doze-hbm-command = [39 01 00 00 00 00 03 51 01 0e];
						qcom,mdss-dsi-doze-lbm-command = [39 01 00 00 00 00 03 51 00 14];
						qcom,mdss-dsi-dispparam-bc-90hz-command = [39 00 00 00 00 00 03 f1 5a 5a 39 00 00 00 00 00 02 60 01 39 00 00 00 00 00 02 f7 07 39 01 00 00 00 00 03 f1 a5 a5];
						qcom,mdss-dsi-dispparam-bc-60hz-command = [39 00 00 00 00 00 03 f1 5a 5a 39 00 00 00 00 00 02 60 21 39 00 00 00 00 00 02 f7 07 39 01 00 00 00 00 03 f1 a5 a5];
						qcom,mdss-dsi-flat-on-command = [39 01 00 00 00 00 03 f1 5a 5a 39 01 00 00 00 00 05 b0 00 88 b1 01 39 01 00 00 00 00 03 b1 27 2d 39 01 00 00 00 00 03 f1 a5 a5];
						qcom,mdss-dsi-flat-off-command = [39 01 00 00 00 00 03 f1 5a 5a 39 01 00 00 00 00 05 b0 00 88 b1 01 39 01 00 00 00 00 03 b1 27 0d 39 01 00 00 00 00 03 f1 a5 a5];
						qcom,mdss-dsi-on-command-state = "dsi_lp_mode";
						qcom,mdss-dsi-off-command-state = "dsi_lp_mode";
						qcom,mdss-dsi-hbm1-on-command-state = "dsi_lp_mode";
						qcom,mdss-dsi-hbm2-on-command-state = "dsi_lp_mode";
						qcom,mdss-dsi-dispparam-hbm-on-command-state = "dsi_lp_mode";
						qcom,mdss-dsi-dispparam-hbm-off-command-state = "dsi_lp_mode";
						qcom,mdss-dsi-doze-hbm-command-state = "dsi_lp_mode";
						qcom,mdss-dsi-doze-lbm-command-state = "dsi_lp_mode";
						qcom,mdss-dsi-dispparam-bc-90hz-command-state = "dsi_hs_mode";
						qcom,mdss-dsi-dispparam-bc-60hz-command-state = "dsi_hs_mode";
						qcom,mdss-dsi-flat-on-command-state = "dsi_lp_mode";
						qcom,mdss-dsi-flat-off-command-state = "dsi_lp_mode";
						qcom,compression-mode = "dsc";
						qcom,mdss-dsc-slice-height = <0x14>;
						qcom,mdss-dsc-slice-width = <0x21c>;
						qcom,mdss-dsc-slice-per-pkt = <0x01>;
						qcom,mdss-dsc-bit-per-component = <0x08>;
						qcom,mdss-dsc-bit-per-pixel = <0x08>;
						qcom,mdss-dsc-block-prediction-enable;
						qcom,mdss-dsi-panel-phy-timings = [00 24 09 0a 1a 25 09 0a 09 02 04 00 1e 0f];
						qcom,display-topology = <0x01 0x01 0x01>;
						qcom,default-topology-index = <0x00>;
					};
				};
			};
		};
	};

	fragment@9 {
		target = <0xffffffff>;

		__overlay__ {

			qcom,mdss_dsi_panel_k7_38_0c_0b_fhdp_video {
				qcom,mdss-dsi-panel-name = "k7 38 0c 0b video mode fhdp dsi panel";
				qcom,mdss-dsi-panel-model = "xiaomi 38 0c 0b VIDEO PANEL";
				qcom,mdss-dsi-panel-type = "dsi_video_mode";
				qcom,dsi-ctrl-num = <0x00>;
				qcom,dsi-phy-num = <0x00>;
				qcom,mdss-dsi-panel-physical-type = "oled";
				qcom,mdss-dsi-virtual-channel-id = <0x00>;
				qcom,mdss-dsi-stream = <0x00>;
				qcom,mdss-dsi-h-left-border = <0x00>;
				qcom,mdss-dsi-h-right-border = <0x00>;
				qcom,mdss-dsi-v-top-border = <0x00>;
				qcom,mdss-dsi-v-bottom-border = <0x00>;
				qcom,mdss-dsi-bpp = <0x18>;
				qcom,mdss-dsi-color-order = "rgb_swap_rgb";
				qcom,mdss-dsi-underflow-color = <0xff>;
				qcom,mdss-dsi-border-color = <0x00>;
				qcom,mdss-dsi-h-sync-pulse = <0x00>;
				qcom,mdss-dsi-traffic-mode = "burst_mode";
				qcom,mdss-dsi-lane-map = "lane_map_0123";
				qcom,mdss-dsi-bllp-eof-power-mode;
				qcom,mdss-dsi-bllp-power-mode;
				qcom,mdss-dsi-tx-eot-append;
				qcom,mdss-dsi-lane-0-state;
				qcom,mdss-dsi-lane-1-state;
				qcom,mdss-dsi-lane-2-state;
				qcom,mdss-dsi-lane-3-state;
				qcom,mdss-dsi-dma-trigger = "trigger_sw";
				qcom,mdss-dsi-mdp-trigger = "none";
				qcom,mdss-dsi-lp11-init;
				qcom,mdss-dsi-bl-pmic-control-type = "bl_ctrl_dcs";
				qcom,mdss-dsi-bl-min-level = <0x01>;
				qcom,dispparam-enabled;
				qcom,mdss-dsi-bl-max-level = <0x7ff>;
				qcom,mdss-dsi-bl-inverted-dbv;
				qcom,mdss-brightness-max-level = <0x7ff>;
				qcom,mdss-dsi-reset-sequence = <0x01 0x0a 0x00 0x0a 0x01 0x0a>;
				qcom,mdss-pan-physical-width-dimension = <0x43>;
				qcom,mdss-pan-physical-height-dimension = <0x95>;
				qcom,mdss-dsi-te-pin-select = <0x01>;
				qcom,mdss-dsi-wr-mem-start = <0x2c>;
				qcom,mdss-dsi-wr-mem-continue = <0x3c>;
				qcom,mdss-dsi-te-dcs-command = <0x01>;
				qcom,mdss-dsi-te-check-enable;
				qcom,mdss-dsi-te-using-te-pin;
				qcom,mdss-dsi-pan-enable-dynamic-fps;
				qcom,mdss-dsi-pan-fps-update = "dfps_immediate_porch_mode_vfp";
				qcom,dsi-supported-dfps-list = <0x5a 0x3c>;
				qcom,esd-err-irq-gpio = <0xffffffff 0x63 0x2001>;
				qcom,mdss-dsi-panel-status-check-mode = "reg_read";
				qcom,mdss-dsi-panel-status-command = <0x6010001 0x10a>;
				qcom,mdss-dsi-panel-status-command-state = "dsi_hs_mode";
				qcom,mdss-dsi-panel-status-value = <0x9f>;
				qcom,mdss-dsi-panel-on-check-value = <0x9f>;
				qcom,mdss-dsi-panel-status-read-length = <0x01>;
				qcom,platform-en-gpio = <0xffffffff 0x09 0x00>;
				qcom,dsi-select-clocks = "mux_byte_clk0\0mux_pixel_clk0";
				qcom,panel-supply-entries = <0x0d>;
				qcom,platform-reset-gpio = <0xffffffff 0x52 0x00>;
				phandle = <0x2d>;

				qcom,mdss-dsi-display-timings {

					timing@0 {
						qcom,mdss-dsi-panel-width = <0x438>;
						qcom,mdss-dsi-panel-height = <0x960>;
						qcom,mdss-dsi-h-pulse-width = <0x20>;
						qcom,mdss-dsi-h-back-porch = <0x78>;
						qcom,mdss-dsi-h-front-porch = <0x140>;
						qcom,mdss-dsi-h-sync-skew = <0x00>;
						qcom,mdss-dsi-v-back-porch = <0x0a>;
						qcom,mdss-dsi-v-front-porch = <0x14>;
						qcom,mdss-dsi-v-pulse-width = <0x02>;
						qcom,mdss-dsi-panel-framerate = <0x5a>;
						qcom,mdss-dsi-on-command = [05 01 00 00 50 00 02 11 00 39 01 00 00 00 00 03 f0 5a 5a 39 01 00 00 00 00 03 b2 01 31 39 01 00 00 00 00 03 f0 a5 a5 39 01 00 00 00 00 03 f0 5a 5a 39 01 00 00 00 00 03 fc 5a 5a 39 01 00 00 00 00 02 e1 8b 39 01 00 00 00 00 03 ed 00 01 39 01 00 00 00 00 04 b0 00 06 f4 39 01 00 00 00 00 02 f4 1f 39 01 00 00 00 00 03 f0 a5 a5 39 01 00 00 00 00 03 fc a5 a5 39 01 00 00 00 00 03 f0 5a 5a 39 01 00 00 00 00 03 fc 5a 5a 39 01 00 00 00 00 04 b0 00 11 fe 39 01 00 00 00 00 02 fe 00 39 01 00 00 00 00 03 f0 a5 a5 39 01 00 00 00 00 03 fc a5 a5 39 01 00 00 00 00 02 9d 01 39 01 00 00 00 00 5a 9e 11 00 00 89 30 80 09 60 04 38 00 28 02 1c 02 1c 02 00 02 0e 00 20 03 dd 00 07 00 0c 02 77 02 8b 18 00 10 f0 03 0c 20 00 06 0b 0b 33 0e 1c 2a 38 46 54 62 69 70 77 79 7b 7d 7e 01 02 01 00 09 40 09 be 19 fc 19 fa 19 f8 1a 38 1a 78 1a b6 2a f6 2b 34 2b 74 3b 74 6b f4 00 39 01 00 00 00 00 03 f0 5a 5a 39 01 00 00 00 00 02 60 21 39 01 00 00 00 00 02 f7 0b 39 01 00 00 00 00 03 f0 a5 a5 39 01 00 00 00 00 03 f0 5a 5a 39 01 00 00 00 00 04 b0 00 0d b2 39 01 00 00 00 00 02 b2 20 39 01 00 00 00 00 04 b0 00 0c b2 39 01 00 00 00 00 02 b2 30 39 01 00 00 00 00 03 f0 a5 a5 39 01 00 00 00 00 02 53 28 39 01 00 00 00 00 02 f7 0b 39 01 00 00 00 00 03 f0 5a 5a 39 01 00 00 00 00 04 cd 29 00 08 39 01 00 00 00 00 03 f0 a5 a5 39 01 00 00 00 00 03 f0 5a 5a 39 01 00 00 00 00 03 fc 5a 5a 39 01 00 00 00 00 02 fe b0 39 01 00 00 00 00 02 fe 30 39 01 00 00 00 00 02 f7 0b 39 01 00 00 00 00 03 fc a5 a5 39 01 00 00 64 00 03 f0 a5 a5 05 01 00 00 1e 00 02 29 00];
						qcom,mdss-dsi-pre-off-command = <0x5010000 0xa000128 0x5010000 0x96000110>;
						qcom,mdss-dsi-hbm1-on-command = [39 01 00 00 00 00 02 53 e8 39 01 00 00 00 00 03 51 04 ee];
						qcom,mdss-dsi-hbm2-on-command = [39 01 00 00 00 00 02 53 e8 39 01 00 00 00 00 03 51 07 ff];
						qcom,mdss-dsi-dispparam-hbm-on-command = <0x39010000 0x253 0xe8390100 0x03 0x5107ff39 0x1000000 0x2f70b>;
						qcom,mdss-dsi-dispparam-hbm-off-command = [39 01 00 00 00 00 02 53 28 39 01 00 00 00 00 02 f7 0b];
						qcom,mdss-dsi-doze-hbm-command = [39 01 00 00 00 00 03 51 01 0e];
						qcom,mdss-dsi-doze-lbm-command = [39 01 00 00 00 00 03 51 00 14];
						qcom,mdss-dsi-dispparam-bc-90hz-command = [39 00 00 00 00 00 03 f0 5a 5a 39 00 00 00 00 00 02 60 01 39 00 00 00 00 00 02 f7 0b 39 01 00 00 00 00 03 f0 a5 a5];
						qcom,mdss-dsi-dispparam-bc-60hz-command = [39 00 00 00 00 00 03 f0 5a 5a 39 00 00 00 00 00 02 60 21 39 00 00 00 00 00 02 f7 0b 39 01 00 00 00 00 03 f0 a5 a5];
						qcom,mdss-dsi-flat-on-command = [39 01 00 00 00 00 03 f0 5a 5a 39 01 00 00 00 00 04 b0 00 88 b1 39 01 00 00 00 00 03 b1 27 2d 39 01 00 00 00 00 03 f0 a5 a5];
						qcom,mdss-dsi-flat-off-command = [39 01 00 00 00 00 03 f0 5a 5a 39 01 00 00 00 00 04 b0 00 88 b1 39 01 00 00 00 00 03 b1 27 0d 39 01 00 00 00 00 03 f0 a5 a5];
						qcom,mdss-dsi-on-command-state = "dsi_lp_mode";
						qcom,mdss-dsi-pre-off-command-state = "dsi_hs_mode";
						qcom,mdss-dsi-hbm1-on-command-state = "dsi_lp_mode";
						qcom,mdss-dsi-hbm2-on-command-state = "dsi_lp_mode";
						qcom,mdss-dsi-dispparam-hbm-on-command-state = "dsi_lp_mode";
						qcom,mdss-dsi-dispparam-hbm-off-command-state = "dsi_lp_mode";
						qcom,mdss-dsi-doze-hbm-command-state = "dsi_lp_mode";
						qcom,mdss-dsi-doze-lbm-command-state = "dsi_lp_mode";
						qcom,mdss-dsi-dispparam-bc-90hz-command-state = "dsi_hs_mode";
						qcom,mdss-dsi-dispparam-bc-60hz-command-state = "dsi_hs_mode";
						qcom,mdss-dsi-flat-on-command-state = "dsi_hs_mode";
						qcom,mdss-dsi-flat-off-command-state = "dsi_hs_mode";
						qcom,compression-mode = "dsc";
						qcom,mdss-dsc-slice-height = <0x14>;
						qcom,mdss-dsc-slice-width = <0x21c>;
						qcom,mdss-dsc-slice-per-pkt = <0x01>;
						qcom,mdss-dsc-bit-per-component = <0x08>;
						qcom,mdss-dsc-bit-per-pixel = <0x08>;
						qcom,mdss-dsc-block-prediction-enable;
						qcom,mdss-dsi-panel-phy-timings = [00 24 09 0a 1a 25 09 0a 09 02 04 00 1e 0f];
						qcom,display-topology = <0x01 0x01 0x01>;
						qcom,default-topology-index = <0x00>;
					};
				};
			};
		};
	};

	fragment@10 {
		target = <0xffffffff>;

		__overlay__ {

			qcom,mdss_dsi_nt36672e_fhd_plus_90hz_video {
				qcom,mdss-dsi-panel-name = "nt36672e 90Hz fhd plus video mode panel with DSC";
				qcom,mdss-dsi-panel-type = "dsi_video_mode";
				qcom,dsi-ctrl-num = <0x00>;
				qcom,dsi-phy-num = <0x00>;
				qcom,mdss-dsi-virtual-channel-id = <0x00>;
				qcom,mdss-dsi-stream = <0x00>;
				qcom,mdss-dsi-bpp = <0x18>;
				qcom,mdss-dsi-border-color = <0x00>;
				qcom,mdss-dsi-traffic-mode = "burst_mode";
				qcom,mdss-dsi-bllp-power-mode;
				qcom,mdss-dsi-bllp-eof-power-mode;
				qcom,mdss-dsi-lane-0-state;
				qcom,mdss-dsi-lane-1-state;
				qcom,mdss-dsi-lane-2-state;
				qcom,mdss-dsi-lane-3-state;
				qcom,mdss-dsi-dma-trigger = "trigger_sw";
				qcom,mdss-dsi-mdp-trigger = "none";
				qcom,mdss-dsi-reset-sequence = <0x01 0x0a 0x00 0x0a 0x01 0x0a>;
				qcom,mdss-dsi-tx-eot-append;
				qcom,adjust-timer-wakeup-ms = <0x01>;
				qcom,mdss-dsi-panel-hdr-enabled;
				qcom,mdss-dsi-panel-hdr-color-primaries = <0x9858 0x3e80 0x83d6 0x9b78 0x33c2 0x8692 0x1d4c 0xbb8>;
				qcom,mdss-dsi-panel-peak-brightness = <0x626b50>;
				qcom,mdss-dsi-panel-blackness-level = <0x1361>;
				qcom,panel-supply-entries = <0x0d>;
				qcom,mdss-dsi-bl-pmic-control-type = "bl_ctrl_pwm";
				pwms = <0xffffffff 0x00 0x00>;
				qcom,bl-pmic-pwm-period-usecs = <0x64>;
				qcom,mdss-dsi-bl-min-level = <0x01>;
				qcom,mdss-dsi-bl-max-level = <0xfff>;
				qcom,platform-reset-gpio = <0xffffffff 0x52 0x00>;
				qcom,platform-en-gpio = <0x0e 0x05 0x00>;
				qcom,platform-bklight-en-gpio = <0x0e 0x01 0x00>;
				phandle = <0x10>;

				qcom,mdss-dsi-display-timings {

					timing@0 {
						qcom,mdss-dsi-panel-width = <0x438>;
						qcom,mdss-dsi-panel-height = <0x968>;
						qcom,mdss-dsi-h-front-porch = <0x4c>;
						qcom,mdss-dsi-h-back-porch = <0x44>;
						qcom,mdss-dsi-h-pulse-width = <0x0a>;
						qcom,mdss-dsi-h-sync-skew = <0x00>;
						qcom,mdss-dsi-v-back-porch = <0x0a>;
						qcom,mdss-dsi-v-front-porch = <0x2e>;
						qcom,mdss-dsi-v-pulse-width = <0x0a>;
						qcom,mdss-dsi-panel-framerate = <0x5a>;
						qcom,mdss-dsi-on-command = [39 01 00 00 00 00 02 ff 10 39 01 00 00 00 00 02 fb 01 39 01 00 00 00 00 02 b0 00 39 01 00 00 00 00 02 c0 03 39 01 00 00 00 00 11 c1 89 28 00 08 00 aa 02 0e 00 2b 00 07 0d b7 0c b7 39 01 00 00 00 00 03 c2 1b a0 39 01 00 00 00 00 02 ff 20 39 01 00 00 00 00 02 fb 01 39 01 00 00 00 00 02 01 66 39 01 00 00 00 00 02 06 40 39 01 00 00 00 00 02 07 38 39 01 00 00 00 00 02 18 66 39 01 00 00 00 00 02 1b 01 39 01 00 00 00 00 02 5c 90 39 01 00 00 00 00 02 5e aa 39 01 00 00 00 00 02 69 91 39 01 00 00 00 00 02 89 0d 39 01 00 00 00 00 02 8a 0d 39 01 00 00 00 00 02 8d 0d 39 01 00 00 00 00 02 8e 0d 39 01 00 00 00 00 02 8f 0d 39 01 00 00 00 00 02 91 0d 39 01 00 00 00 00 02 95 d1 39 01 00 00 00 00 02 96 d1 39 01 00 00 00 00 02 f2 65 39 01 00 00 00 00 02 f3 64 39 01 00 00 00 00 02 f4 65 39 01 00 00 00 00 02 f5 64 39 01 00 00 00 00 02 f6 65 39 01 00 00 00 00 02 f7 64 39 01 00 00 00 00 02 f8 65 39 01 00 00 00 00 02 f9 64 39 01 00 00 00 00 02 ff 24 39 01 00 00 00 00 02 fb 01 39 01 00 00 00 00 02 01 0f 39 01 00 00 00 00 02 03 0c 39 01 00 00 00 00 02 05 1d 39 01 00 00 00 00 02 08 2f 39 01 00 00 00 00 02 09 2e 39 01 00 00 00 00 02 0a 2d 39 01 00 00 00 00 02 0b 2c 39 01 00 00 00 00 02 11 17 39 01 00 00 00 00 02 12 13 39 01 00 00 00 00 02 13 15 39 01 00 00 00 00 02 15 14 39 01 00 00 00 00 02 16 16 39 01 00 00 00 00 02 17 18 39 01 00 00 00 00 02 1b 01 39 01 00 00 00 00 02 1d 1d 39 01 00 00 00 00 02 20 2f 39 01 00 00 00 00 02 21 2e 39 01 00 00 00 00 02 22 2d 39 01 00 00 00 00 02 23 2c 39 01 00 00 00 00 02 29 17 39 01 00 00 00 00 02 2a 13 39 01 00 00 00 00 02 2b 15 39 01 00 00 00 00 02 2f 14 39 01 00 00 00 00 02 30 16 39 01 00 00 00 00 02 31 18 39 01 00 00 00 00 02 32 04 39 01 00 00 00 00 02 34 10 39 01 00 00 00 00 02 35 1f 39 01 00 00 00 00 02 36 1f 39 01 00 00 00 00 02 4d 19 39 01 00 00 00 00 02 4e 45 39 01 00 00 00 00 02 4f 45 39 01 00 00 00 00 02 53 45 39 01 00 00 00 00 02 71 30 39 01 00 00 00 00 02 79 11 39 01 00 00 00 00 02 7a 82 39 01 00 00 00 00 02 7b 94 39 01 00 00 00 00 02 7d 04 39 01 00 00 00 00 02 80 04 39 01 00 00 00 00 02 81 04 39 01 00 00 00 00 02 82 13 39 01 00 00 00 00 02 84 31 39 01 00 00 00 00 02 85 00 39 01 00 00 00 00 02 86 00 39 01 00 00 00 00 02 87 00 39 01 00 00 00 00 02 90 13 39 01 00 00 00 00 02 92 31 39 01 00 00 00 00 02 93 00 39 01 00 00 00 00 02 94 00 39 01 00 00 00 00 02 95 00 39 01 00 00 00 00 02 9c f4 39 01 00 00 00 00 02 9d 01 39 01 00 00 00 00 02 a0 14 39 01 00 00 00 00 02 a2 14 39 01 00 00 00 00 02 a3 02 39 01 00 00 00 00 02 a4 04 39 01 00 00 00 00 02 a5 04 39 01 00 00 00 00 02 c4 40 39 01 00 00 00 00 02 c6 c0 39 01 00 00 00 00 02 c9 00 39 01 00 00 00 00 02 d9 80 39 01 00 00 00 00 02 e9 02 39 01 00 00 00 00 02 ff 25 39 01 00 00 00 00 02 fb 01 39 01 00 00 00 00 02 0f 1b 39 01 00 00 00 00 02 19 e4 39 01 00 00 00 00 02 21 40 39 01 00 00 00 00 02 66 d8 39 01 00 00 00 00 02 68 50 39 01 00 00 00 00 02 69 10 39 01 00 00 00 00 02 6b 00 39 01 00 00 00 00 02 6d 0d 39 01 00 00 00 00 02 6e 48 39 01 00 00 00 00 02 72 41 39 01 00 00 00 00 02 73 4a 39 01 00 00 00 00 02 74 d0 39 01 00 00 00 00 02 77 62 39 01 00 00 00 00 02 79 7f 39 01 00 00 00 00 02 7d 40 39 01 00 00 00 00 02 7f 00 39 01 00 00 00 00 02 80 04 39 01 00 00 00 00 02 84 0d 39 01 00 00 00 00 02 cf 80 39 01 00 00 00 00 02 d6 80 39 01 00 00 00 00 02 d7 80 39 01 00 00 00 00 02 ef 20 39 01 00 00 00 00 02 f0 84 39 01 00 00 00 00 02 ff 26 39 01 00 00 00 00 02 fb 01 39 01 00 00 00 00 02 15 04 39 01 00 00 00 00 02 81 14 39 01 00 00 00 00 02 83 02 39 01 00 00 00 00 02 84 03 39 01 00 00 00 00 02 85 01 39 01 00 00 00 00 02 86 03 39 01 00 00 00 00 02 87 01 39 01 00 00 00 00 02 88 06 39 01 00 00 00 00 02 8a 1a 39 01 00 00 00 00 02 8b 11 39 01 00 00 00 00 02 8c 24 39 01 00 00 00 00 02 8e 42 39 01 00 00 00 00 02 8f 11 39 01 00 00 00 00 02 90 11 39 01 00 00 00 00 02 91 11 39 01 00 00 00 00 02 9a 81 39 01 00 00 00 00 02 9b 03 39 01 00 00 00 00 02 9c 00 39 01 00 00 00 00 02 9d 00 39 01 00 00 00 00 02 9e 00 39 01 00 00 00 00 02 ff 27 39 01 00 00 00 00 02 fb 01 39 01 00 00 00 00 02 01 68 39 01 00 00 00 00 02 20 81 39 01 00 00 00 00 02 21 ea 39 01 00 00 00 00 02 25 82 39 01 00 00 00 00 02 26 1f 39 01 00 00 00 00 02 6e 00 39 01 00 00 00 00 02 6f 00 39 01 00 00 00 00 02 70 00 39 01 00 00 00 00 02 71 00 39 01 00 00 00 00 02 72 00 39 01 00 00 00 00 02 75 00 39 01 00 00 00 00 02 76 00 39 01 00 00 00 00 02 77 00 39 01 00 00 00 00 02 7d 09 39 01 00 00 00 00 02 7e 67 39 01 00 00 00 00 02 80 23 39 01 00 00 00 00 02 82 09 39 01 00 00 00 00 02 83 67 39 01 00 00 00 00 02 88 01 39 01 00 00 00 00 02 89 10 39 01 00 00 00 00 02 a5 10 39 01 00 00 00 00 02 a6 23 39 01 00 00 00 00 02 a7 01 39 01 00 00 00 00 02 b6 40 39 01 00 00 00 00 02 e3 02 39 01 00 00 00 00 02 e4 e0 39 01 00 00 00 00 02 e5 01 39 01 00 00 00 00 02 e6 70 39 01 00 00 00 00 02 e9 03 39 01 00 00 00 00 02 ea 2f 39 01 00 00 00 00 02 eb 01 39 01 00 00 00 00 02 ec 98 39 01 00 00 00 00 02 ff 2a 39 01 00 00 00 00 02 fb 01 39 01 00 00 00 00 02 00 91 39 01 00 00 00 00 02 03 20 39 01 00 00 00 00 02 07 5a 39 01 00 00 00 00 02 0a 70 39 01 00 00 00 00 02 0d 40 39 01 00 00 00 00 02 0e 02 39 01 00 00 00 00 02 11 f0 39 01 00 00 00 00 02 15 0f 39 01 00 00 00 00 02 16 65 39 01 00 00 00 00 02 19 0f 39 01 00 00 00 00 02 1a 39 39 01 00 00 00 00 02 1b 14 39 01 00 00 00 00 02 1d 36 39 01 00 00 00 00 02 1e 4f 39 01 00 00 00 00 02 1f 4f 39 01 00 00 00 00 02 20 4f 39 01 00 00 00 00 02 28 e4 39 01 00 00 00 00 02 29 17 39 01 00 00 00 00 02 2a f5 39 01 00 00 00 00 02 2d 06 39 01 00 00 00 00 02 2f 04 39 01 00 00 00 00 02 30 54 39 01 00 00 00 00 02 33 04 39 01 00 00 00 00 02 34 e6 39 01 00 00 00 00 02 35 32 39 01 00 00 00 00 02 36 02 39 01 00 00 00 00 02 37 e1 39 01 00 00 00 00 02 38 36 39 01 00 00 00 00 02 39 fe 39 01 00 00 00 00 02 3a 14 39 01 00 00 00 00 02 46 40 39 01 00 00 00 00 02 47 02 39 01 00 00 00 00 02 4a f0 39 01 00 00 00 00 02 4e 0f 39 01 00 00 00 00 02 4f 65 39 01 00 00 00 00 02 52 0f 39 01 00 00 00 00 02 53 39 39 01 00 00 00 00 02 54 14 39 01 00 00 00 00 02 56 36 39 01 00 00 00 00 02 57 7e 39 01 00 00 00 00 02 58 7e 39 01 00 00 00 00 02 59 7e 39 01 00 00 00 00 02 60 80 39 01 00 00 00 00 02 61 c9 39 01 00 00 00 00 02 62 03 39 01 00 00 00 00 02 63 fb 39 01 00 00 00 00 02 64 03 39 01 00 00 00 00 02 65 05 39 01 00 00 00 00 02 66 01 39 01 00 00 00 00 02 67 04 39 01 00 00 00 00 02 68 91 39 01 00 00 00 00 02 6a 19 39 01 00 00 00 00 02 6b cb 39 01 00 00 00 00 02 6c 20 39 01 00 00 00 00 02 6d e5 39 01 00 00 00 00 02 6e c8 39 01 00 00 00 00 02 6f 22 39 01 00 00 00 00 02 70 e3 39 01 00 00 00 00 02 71 04 39 01 00 00 00 00 02 7a 07 39 01 00 00 00 00 02 7b 40 39 01 00 00 00 00 02 7d 01 39 01 00 00 00 00 02 7f 2c 39 01 00 00 00 00 02 83 0f 39 01 00 00 00 00 02 84 65 39 01 00 00 00 00 02 87 0f 39 01 00 00 00 00 02 88 39 39 01 00 00 00 00 02 89 14 39 01 00 00 00 00 02 8b 36 39 01 00 00 00 00 02 8c 39 39 01 00 00 00 00 02 8d 39 39 01 00 00 00 00 02 8e 39 39 01 00 00 00 00 02 95 80 39 01 00 00 00 00 02 96 fd 39 01 00 00 00 00 02 97 14 39 01 00 00 00 00 02 98 b3 39 01 00 00 00 00 02 99 01 39 01 00 00 00 00 02 9a 08 39 01 00 00 00 00 02 9b 02 39 01 00 00 00 00 02 9c 4c 39 01 00 00 00 00 02 9d bc 39 01 00 00 00 00 02 9f ac 39 01 00 00 00 00 02 a0 ff 39 01 00 00 00 00 02 a2 44 39 01 00 00 00 00 02 a3 78 39 01 00 00 00 00 02 a4 f8 39 01 00 00 00 00 02 a5 4a 39 01 00 00 00 00 02 a6 72 39 01 00 00 00 00 02 a7 4c 39 01 00 00 00 00 02 ff 2c 39 01 00 00 00 00 02 fb 01 39 01 00 00 00 00 02 00 02 39 01 00 00 00 00 02 01 02 39 01 00 00 00 00 02 02 02 39 01 00 00 00 00 02 03 16 39 01 00 00 00 00 02 04 16 39 01 00 00 00 00 02 05 16 39 01 00 00 00 00 02 0d 1f 39 01 00 00 00 00 02 0e 1f 39 01 00 00 00 00 02 16 1b 39 01 00 00 00 00 02 17 4b 39 01 00 00 00 00 02 18 4b 39 01 00 00 00 00 02 19 4b 39 01 00 00 00 00 02 2a 03 39 01 00 00 00 00 02 4d 16 39 01 00 00 00 00 02 4e 02 39 01 00 00 00 00 02 4f 2f 39 01 00 00 00 00 02 53 02 39 01 00 00 00 00 02 54 02 39 01 00 00 00 00 02 55 02 39 01 00 00 00 00 02 56 0e 39 01 00 00 00 00 02 58 0e 39 01 00 00 00 00 02 59 0e 39 01 00 00 00 00 02 61 1f 39 01 00 00 00 00 02 62 1f 39 01 00 00 00 00 02 6a 14 39 01 00 00 00 00 02 6b 34 39 01 00 00 00 00 02 6c 34 39 01 00 00 00 00 02 6d 34 39 01 00 00 00 00 02 7e 03 39 01 00 00 00 00 02 9d 0e 39 01 00 00 00 00 02 9e 02 39 01 00 00 00 00 02 9f 02 39 01 00 00 00 00 02 ff 20 39 01 00 00 00 00 02 fb 01 39 01 00 00 00 00 11 b0 00 00 00 15 00 3f 00 5f 00 7e 00 97 00 af 00 c3 39 01 00 00 00 00 11 b1 00 d7 01 0a 01 32 01 6f 01 9e 01 e5 02 1d 02 1e 39 01 00 00 00 00 11 b2 02 56 02 94 02 bc 02 f1 03 13 03 41 03 4f 03 5f 39 01 00 00 00 00 0f b3 03 71 03 84 03 99 03 b0 03 ca 03 d7 00 00 39 01 00 00 00 00 11 b4 00 00 00 17 00 46 00 69 00 8c 00 a5 00 be 00 d1 39 01 00 00 00 00 11 b5 00 e4 01 18 01 40 01 7c 01 aa 01 f0 02 27 02 28 39 01 00 00 00 00 11 b6 02 5e 02 9b 02 c3 02 f6 03 18 03 45 03 54 03 63 39 01 00 00 00 00 0f b7 03 75 03 87 03 9c 03 b2 03 ca 03 d7 00 00 39 01 00 00 00 00 11 b8 00 00 00 18 00 49 00 6b 00 8e 00 a8 00 c1 00 d3 39 01 00 00 00 00 11 b9 00 e5 01 18 01 3f 01 7b 01 a8 01 ec 02 24 02 26 39 01 00 00 00 00 11 ba 02 5a 02 97 02 c0 02 f4 03 15 03 43 03 51 03 61 39 01 00 00 00 00 0f bb 03 72 03 85 03 9a 03 b1 03 ca 03 d7 00 00 39 01 00 00 00 00 02 c6 00 39 01 00 00 00 00 02 c7 00 39 01 00 00 00 00 02 c8 00 39 01 00 00 00 00 02 c9 00 39 01 00 00 00 00 02 ca 00 39 01 00 00 00 00 02 cb 00 39 01 00 00 00 00 02 cc 00 39 01 00 00 00 00 02 cd 00 39 01 00 00 00 00 02 ce 00 39 01 00 00 00 00 02 cf 00 39 01 00 00 00 00 02 d0 00 39 01 00 00 00 00 02 d1 00 39 01 00 00 00 00 02 d2 00 39 01 00 00 00 00 02 d3 00 39 01 00 00 00 00 02 d4 00 39 01 00 00 00 00 02 d5 00 39 01 00 00 00 00 02 d6 00 39 01 00 00 00 00 02 d7 00 39 01 00 00 00 00 02 d8 00 39 01 00 00 00 00 02 d9 00 39 01 00 00 00 00 02 da 00 39 01 00 00 00 00 02 db 00 39 01 00 00 00 00 02 dc 00 39 01 00 00 00 00 02 dd 00 39 01 00 00 00 00 02 de 00 39 01 00 00 00 00 02 df 00 39 01 00 00 00 00 02 e0 00 39 01 00 00 00 00 02 e1 00 39 01 00 00 00 00 02 e2 00 39 01 00 00 00 00 02 e3 00 39 01 00 00 00 00 02 e4 00 39 01 00 00 00 00 02 e5 00 39 01 00 00 00 00 02 e6 00 39 01 00 00 00 00 02 e7 00 39 01 00 00 00 00 02 e8 00 39 01 00 00 00 00 02 e9 00 39 01 00 00 00 00 02 ff 21 39 01 00 00 00 00 02 fb 01 39 01 00 00 00 00 11 b0 00 00 00 15 00 3f 00 5f 00 7e 00 97 00 af 00 c3 39 01 00 00 00 00 11 b1 00 d7 01 0a 01 32 01 6f 01 9e 01 e5 02 1d 02 1e 39 01 00 00 00 00 11 b2 02 56 02 94 02 bc 02 f1 03 13 03 41 03 4f 03 5f 39 01 00 00 00 00 0f b3 03 71 03 84 03 99 03 b0 03 ca 03 d7 00 00 39 01 00 00 00 00 11 b4 00 00 00 17 00 46 00 69 00 8c 00 a5 00 be 00 d1 39 01 00 00 00 00 11 b5 00 e4 01 18 01 40 01 7c 01 aa 01 f0 02 27 02 28 39 01 00 00 00 00 11 b6 02 5e 02 9b 02 c3 02 f6 03 18 03 45 03 54 03 63 39 01 00 00 00 00 0f b7 03 75 03 87 03 9c 03 b2 03 ca 03 d7 00 00 39 01 00 00 00 00 11 b8 00 00 00 18 00 49 00 6b 00 8e 00 a8 00 c1 00 d3 39 01 00 00 00 00 11 b9 00 e5 01 18 01 3f 01 7b 01 a8 01 ec 02 24 02 26 39 01 00 00 00 00 11 ba 02 5a 02 97 02 c0 02 f4 03 15 03 43 03 51 03 61 39 01 00 00 00 00 0f bb 03 72 03 85 03 9a 03 b1 03 ca 03 d7 00 00 39 01 00 00 00 00 02 ff e0 39 01 00 00 00 00 02 fb 01 39 01 00 00 00 00 02 35 82 39 01 00 00 00 00 02 85 32 39 01 00 00 00 00 02 ff f0 39 01 00 00 00 00 02 fb 01 39 01 00 00 00 00 02 1c 01 39 01 00 00 00 00 02 33 01 39 01 00 00 00 00 02 5a 00 39 01 00 00 00 00 02 ff d0 39 01 00 00 00 00 02 fb 01 39 01 00 00 00 00 02 53 22 39 01 00 00 00 00 02 54 02 39 01 00 00 00 00 02 ff c0 39 01 00 00 00 00 02 fb 01 39 01 00 00 00 00 02 9c 11 39 01 00 00 00 00 02 9d 11 39 01 00 00 00 00 02 ff 2b 39 01 00 00 00 00 02 fb 01 39 01 00 00 00 00 02 b7 0a 39 01 00 00 00 00 02 b8 1c 39 01 00 00 00 00 02 c0 01 39 01 00 00 00 00 02 ff 10 39 01 00 00 00 00 02 35 01 39 01 00 00 00 00 02 51 ff 39 01 00 00 00 00 02 53 0c 39 01 00 00 00 00 02 55 00 05 01 00 00 78 00 01 11 05 01 00 00 28 00 01 29];
						qcom,mdss-dsi-on-command-state = "dsi_lp_mode";
						qcom,mdss-dsi-off-command = <0x5010000 0x10000128 0x5010000 0x32000110>;
						qcom,mdss-dsi-off-command-state = "dsi_lp_mode";
						qcom,compression-mode = "dsc";
						qcom,mdss-dsc-slice-height = <0x08>;
						qcom,mdss-dsc-slice-width = <0x21c>;
						qcom,mdss-dsc-slice-per-pkt = <0x01>;
						qcom,mdss-dsc-bit-per-component = <0x08>;
						qcom,mdss-dsc-bit-per-pixel = <0x08>;
						qcom,mdss-dsc-block-prediction-enable;
					};
				};
			};
		};
	};

	fragment@11 {
		target = <0xffffffff>;

		__overlay__ {

			qcom,mdss_dsi_nt36672e_fhd_plus_120hz_video {
				qcom,mdss-dsi-panel-name = "nt36672e fhd plus 120Hz Video panel";
				qcom,mdss-dsi-panel-type = "dsi_video_mode";
				qcom,dsi-ctrl-num = <0x00>;
				qcom,dsi-phy-num = <0x00>;
				qcom,mdss-dsi-virtual-channel-id = <0x00>;
				qcom,mdss-dsi-stream = <0x00>;
				qcom,mdss-dsi-bpp = <0x18>;
				qcom,mdss-dsi-border-color = <0x00>;
				qcom,mdss-dsi-traffic-mode = "burst_mode";
				qcom,mdss-dsi-bllp-power-mode;
				qcom,mdss-dsi-bllp-eof-power-mode;
				qcom,mdss-dsi-lane-0-state;
				qcom,mdss-dsi-lane-1-state;
				qcom,mdss-dsi-lane-2-state;
				qcom,mdss-dsi-lane-3-state;
				qcom,mdss-dsi-dma-trigger = "trigger_sw";
				qcom,mdss-dsi-mdp-trigger = "none";
				qcom,mdss-dsi-reset-sequence = <0x01 0x0a 0x00 0x0a 0x01 0x0a>;
				qcom,mdss-dsi-tx-eot-append;
				qcom,adjust-timer-wakeup-ms = <0x01>;
				qcom,mdss-dsi-panel-hdr-enabled;
				qcom,mdss-dsi-panel-hdr-color-primaries = <0x3a98 0x3e80 0x83d6 0x3db8 0x33c2 0x8692 0x1d4c 0xbb8>;
				qcom,mdss-dsi-panel-peak-brightness = <0x626b50>;
				qcom,mdss-dsi-panel-blackness-level = <0x1361>;
				phandle = <0x11>;

				qcom,mdss-dsi-display-timings {

					timing@0 {
						qcom,mdss-dsi-panel-width = <0x438>;
						qcom,mdss-dsi-panel-height = <0x968>;
						qcom,mdss-dsi-h-front-porch = <0x4c>;
						qcom,mdss-dsi-h-back-porch = <0x3c>;
						qcom,mdss-dsi-h-pulse-width = <0x0a>;
						qcom,mdss-dsi-h-sync-skew = <0x00>;
						qcom,mdss-dsi-v-back-porch = <0x0a>;
						qcom,mdss-dsi-v-front-porch = <0x2e>;
						qcom,mdss-dsi-v-pulse-width = <0x0a>;
						qcom,mdss-dsi-panel-framerate = <0x78>;
						qcom,mdss-dsi-on-command = [15 01 00 00 00 00 02 fb 01 15 01 00 00 00 00 02 b0 00 15 01 00 00 00 00 02 c0 03 39 01 00 00 00 00 11 c1 89 28 00 08 00 aa 02 0e 00 2b 00 07 0d b7 0c b7 39 01 00 00 00 00 03 c2 1b a0 15 01 00 00 00 00 02 ff 20 15 01 00 00 00 00 02 fb 01 15 01 00 00 00 00 02 01 66 15 01 00 00 00 00 02 06 40 15 01 00 00 00 00 02 07 38 15 01 00 00 00 00 02 2f 83 15 01 00 00 00 00 02 69 91 15 01 00 00 00 00 02 95 d1 15 01 00 00 00 00 02 96 d1 15 01 00 00 00 00 02 f2 64 15 01 00 00 00 00 02 f4 64 15 01 00 00 00 00 02 f6 64 15 01 00 00 00 00 02 f8 64 15 01 00 00 00 00 02 89 1c 15 01 00 00 00 00 02 8a 1c 15 01 00 00 00 00 02 8b 1c 15 01 00 00 00 00 02 8c 1c 15 01 00 00 00 00 02 ff 24 15 01 00 00 00 00 02 fb 01 15 01 00 00 00 00 02 01 0f 15 01 00 00 00 00 02 03 0c 15 01 00 00 00 00 02 05 1d 15 01 00 00 00 00 02 08 2f 15 01 00 00 00 00 02 09 2e 15 01 00 00 00 00 02 0a 2d 15 01 00 00 00 00 02 0b 2c 15 01 00 00 00 00 02 11 17 15 01 00 00 00 00 02 12 13 15 01 00 00 00 00 02 13 15 15 01 00 00 00 00 02 15 14 15 01 00 00 00 00 02 16 16 15 01 00 00 00 00 02 17 18 15 01 00 00 00 00 02 1b 01 15 01 00 00 00 00 02 1d 1d 15 01 00 00 00 00 02 20 2f 15 01 00 00 00 00 02 21 2e 15 01 00 00 00 00 02 22 2d 15 01 00 00 00 00 02 23 2c 15 01 00 00 00 00 02 29 17 15 01 00 00 00 00 02 2a 13 15 01 00 00 00 00 02 2b 15 15 01 00 00 00 00 02 2f 14 15 01 00 00 00 00 02 30 16 15 01 00 00 00 00 02 31 18 15 01 00 00 00 00 02 32 04 15 01 00 00 00 00 02 34 10 15 01 00 00 00 00 02 35 1f 15 01 00 00 00 00 02 36 1f 15 01 00 00 00 00 02 4d 14 15 01 00 00 00 00 02 4e 36 15 01 00 00 00 00 02 4f 36 15 01 00 00 00 00 02 53 36 15 01 00 00 00 00 02 71 30 15 01 00 00 00 00 02 79 11 15 01 00 00 00 00 02 7a 82 15 01 00 00 00 00 02 7b 8f 15 01 00 00 00 00 02 7d 04 15 01 00 00 00 00 02 80 04 15 01 00 00 00 00 02 81 04 15 01 00 00 00 00 02 82 13 15 01 00 00 00 00 02 84 31 15 01 00 00 00 00 02 85 00 15 01 00 00 00 00 02 86 00 15 01 00 00 00 00 02 87 00 15 01 00 00 00 00 02 90 13 15 01 00 00 00 00 02 92 31 15 01 00 00 00 00 02 93 00 15 01 00 00 00 00 02 94 00 15 01 00 00 00 00 02 95 00 15 01 00 00 00 00 02 9c f4 15 01 00 00 00 00 02 9d 01 15 01 00 00 00 00 02 a0 0f 15 01 00 00 00 00 02 a2 0f 15 01 00 00 00 00 02 a3 02 15 01 00 00 00 00 02 a4 04 15 01 00 00 00 00 02 a5 04 15 01 00 00 00 00 02 c4 40 15 01 00 00 00 00 02 c6 c0 15 01 00 00 00 00 02 c9 00 15 01 00 00 00 00 02 d9 80 15 01 00 00 00 00 02 e9 02 15 01 00 00 00 00 02 ff 25 15 01 00 00 00 00 02 fb 01 15 01 00 00 00 00 02 19 e4 15 01 00 00 00 00 02 21 40 15 01 00 00 00 00 02 66 d8 15 01 00 00 00 00 02 68 50 15 01 00 00 00 00 02 69 10 15 01 00 00 00 00 02 6b 00 15 01 00 00 00 00 02 6d 0d 15 01 00 00 00 00 02 6e 48 15 01 00 00 00 00 02 72 41 15 01 00 00 00 00 02 73 4a 15 01 00 00 00 00 02 74 d0 15 01 00 00 00 00 02 77 62 15 01 00 00 00 00 02 79 81 15 01 00 00 00 00 02 7d 03 15 01 00 00 00 00 02 7e 15 15 01 00 00 00 00 02 7f 00 15 01 00 00 00 00 02 84 4d 15 01 00 00 00 00 02 cf 80 15 01 00 00 00 00 02 d6 80 15 01 00 00 00 00 02 d7 80 15 01 00 00 00 00 02 ef 20 15 01 00 00 00 00 02 f0 84 15 01 00 00 00 00 02 ff 26 15 01 00 00 00 00 02 fb 01 15 01 00 00 00 00 02 80 05 15 01 00 00 00 00 02 81 0f 15 01 00 00 00 00 02 83 01 15 01 00 00 00 00 02 84 03 15 01 00 00 00 00 02 85 01 15 01 00 00 00 00 02 86 03 15 01 00 00 00 00 02 87 01 15 01 00 00 00 00 02 88 05 15 01 00 00 00 00 02 8a 1a 15 01 00 00 00 00 02 8b 11 15 01 00 00 00 00 02 8c 24 15 01 00 00 00 00 02 8e 42 15 01 00 00 00 00 02 8f 11 15 01 00 00 00 00 02 90 11 15 01 00 00 00 00 02 91 11 15 01 00 00 00 00 02 9a 80 15 01 00 00 00 00 02 9b 04 15 01 00 00 00 00 02 9c 00 15 01 00 00 00 00 02 9d 00 15 01 00 00 00 00 02 9e 00 15 01 00 00 00 00 02 ff 27 15 01 00 00 00 00 02 fb 01 15 01 00 00 00 00 02 01 68 15 01 00 00 00 00 02 20 81 15 01 00 00 00 00 02 21 6a 15 01 00 00 00 00 02 25 81 15 01 00 00 00 00 02 26 94 15 01 00 00 00 00 02 6e 00 15 01 00 00 00 00 02 6f 00 15 01 00 00 00 00 02 70 00 15 01 00 00 00 00 02 71 00 15 01 00 00 00 00 02 72 00 15 01 00 00 00 00 02 75 00 15 01 00 00 00 00 02 76 00 15 01 00 00 00 00 02 77 00 15 01 00 00 00 00 02 7d 09 15 01 00 00 00 00 02 7e 67 15 01 00 00 00 00 02 80 23 15 01 00 00 00 00 02 82 09 15 01 00 00 00 00 02 83 67 15 01 00 00 00 00 02 88 01 15 01 00 00 00 00 02 89 10 15 01 00 00 00 00 02 a5 10 15 01 00 00 00 00 02 a6 23 15 01 00 00 00 00 02 a7 01 15 01 00 00 00 00 02 b6 40 15 01 00 00 00 00 02 ff 2a 15 01 00 00 00 00 02 fb 01 15 01 00 00 00 00 02 00 91 15 01 00 00 00 00 02 03 20 15 01 00 00 00 00 02 07 50 15 01 00 00 00 00 02 0a 70 15 01 00 00 00 00 02 0c 04 15 01 00 00 00 00 02 0d 40 15 01 00 00 00 00 02 0f 01 15 01 00 00 00 00 02 11 e0 15 01 00 00 00 00 02 15 0f 15 01 00 00 00 00 02 16 a4 15 01 00 00 00 00 02 19 0f 15 01 00 00 00 00 02 1a 78 15 01 00 00 00 00 02 1b 23 15 01 00 00 00 00 02 1d 36 15 01 00 00 00 00 02 1e 3e 15 01 00 00 00 00 02 1f 3e 15 01 00 00 00 00 02 20 3e 15 01 00 00 00 00 02 28 fd 15 01 00 00 00 00 02 29 12 15 01 00 00 00 00 02 2a e1 15 01 00 00 00 00 02 2d 0a 15 01 00 00 00 00 02 30 49 15 01 00 00 00 00 02 33 96 15 01 00 00 00 00 02 34 ff 15 01 00 00 00 00 02 35 40 15 01 00 00 00 00 02 36 de 15 01 00 00 00 00 02 37 f9 15 01 00 00 00 00 02 38 45 15 01 00 00 00 00 02 39 d9 15 01 00 00 00 00 02 3a 49 15 01 00 00 00 00 02 4a f0 15 01 00 00 00 00 02 ff 20 15 01 00 00 00 00 02 fb 01 39 01 00 00 00 00 11 b0 00 00 00 17 00 46 00 63 00 81 00 96 00 ab 00 bd 39 01 00 00 00 00 11 b1 00 cf 01 03 01 2f 01 6e 01 9d 01 e7 02 22 02 24 39 01 00 00 00 00 11 b2 02 5d 02 9b 02 c4 02 f9 03 1b 03 48 03 56 03 65 39 01 00 00 00 00 0f b3 03 75 03 87 03 9b 03 b1 03 ca 03 d7 00 00 39 01 00 00 00 00 11 b4 00 00 00 19 00 4b 00 69 00 87 00 9c 00 b2 00 c3 39 01 00 00 00 00 11 b5 00 d5 01 0b 01 35 01 73 01 a3 01 ec 02 27 02 29 39 01 00 00 00 00 11 b6 02 60 02 9f 02 c7 02 fb 03 1d 03 4c 03 5a 03 69 39 01 00 00 00 00 0f b7 03 7a 03 8c 03 a0 03 b5 03 cb 03 d7 00 00 39 01 00 00 00 00 11 b8 00 00 00 19 00 4d 00 6a 00 87 00 9c 00 b1 00 c2 39 01 00 00 00 00 11 b9 00 d3 01 08 01 32 01 70 01 9f 01 e8 02 23 02 25 39 01 00 00 00 00 11 ba 02 5c 02 9b 02 c3 02 f8 03 1a 03 4c 03 5b 03 6b 39 01 00 00 00 00 0f bb 03 7d 03 92 03 a7 03 bb 03 ce 03 d7 00 00 15 01 00 00 00 00 02 ff 21 15 01 00 00 00 00 02 fb 01 39 01 00 00 00 00 11 b0 00 00 00 17 00 46 00 63 00 81 00 96 00 ab 00 bd 39 01 00 00 00 00 11 b1 00 cf 01 03 01 2f 01 6e 01 9d 01 e7 02 22 02 24 39 01 00 00 00 00 11 b2 02 5d 02 9b 02 c4 02 f9 03 1b 03 48 03 56 03 65 39 01 00 00 00 00 0f b3 03 75 03 87 03 9b 03 b1 03 ca 03 d7 00 00 39 01 00 00 00 00 11 b4 00 00 00 19 00 4b 00 69 00 87 00 9c 00 b2 00 c3 39 01 00 00 00 00 11 b5 00 d5 01 0b 01 35 01 73 01 a3 01 ec 02 27 02 29 39 01 00 00 00 00 11 b6 02 60 02 9f 02 c7 02 fb 03 1d 03 4c 03 5a 03 69 39 01 00 00 00 00 0f b7 03 7a 03 8c 03 a0 03 b5 03 cb 03 d7 00 00 39 01 00 00 00 00 11 b8 00 00 00 19 00 4d 00 6a 00 87 00 9c 00 b1 00 c2 39 01 00 00 00 00 11 b9 00 d3 01 08 01 32 01 70 01 9f 01 e8 02 23 02 25 39 01 00 00 00 00 11 ba 02 5c 02 9b 02 c3 02 f8 03 1a 03 4c 03 5b 03 6b 39 01 00 00 00 00 0f bb 03 7d 03 92 03 a7 03 bb 03 ce 03 d7 00 00 15 01 00 00 00 00 02 ff 10 15 01 00 00 00 00 02 ff f0 15 01 00 00 00 00 02 fb 01 15 01 00 00 00 00 02 5a 00 15 01 00 00 00 00 02 ff 10 15 01 00 00 00 00 02 ff 10 15 01 00 00 00 00 02 fb 01 15 01 00 00 00 00 02 51 ff 15 01 00 00 00 00 02 53 2c 15 01 00 00 00 00 02 55 01 05 01 00 00 c8 00 01 11 05 01 00 00 96 00 01 29];
						qcom,mdss-dsi-on-command-state = "dsi_lp_mode";
						qcom,mdss-dsi-off-command = <0x5010000 0x10000128 0x5010000 0x32000110>;
						qcom,mdss-dsi-off-command-state = "dsi_lp_mode";
						qcom,compression-mode = "dsc";
						qcom,mdss-dsc-slice-height = <0x08>;
						qcom,mdss-dsc-slice-width = <0x21c>;
						qcom,mdss-dsc-slice-per-pkt = <0x01>;
						qcom,mdss-dsc-bit-per-component = <0x08>;
						qcom,mdss-dsc-bit-per-pixel = <0x08>;
						qcom,mdss-dsc-block-prediction-enable;
					};
				};
			};
		};
	};

	fragment@12 {
		target = <0xffffffff>;

		__overlay__ {

			qcom,mdss_dsi_sim_video {
				qcom,mdss-dsi-panel-name = "Simulator video mode dsi panel";
				qcom,mdss-dsi-panel-type = "dsi_video_mode";
				qcom,dsi-ctrl-num = <0x00>;
				qcom,dsi-phy-num = <0x00>;
				qcom,mdss-dsi-virtual-channel-id = <0x00>;
				qcom,mdss-dsi-stream = <0x00>;
				qcom,mdss-dsi-bpp = <0x18>;
				qcom,mdss-dsi-underflow-color = <0xff>;
				qcom,mdss-dsi-border-color = <0x00>;
				qcom,mdss-dsi-panel-hdr-enabled;
				qcom,mdss-dsi-panel-hdr-color-primaries = <0x38a4 0x3c8c 0x7d00 0x4268 0x3c8c 0x7530 0x1f40 0xbb8>;
				qcom,mdss-dsi-panel-peak-brightness = <0x401640>;
				qcom,mdss-dsi-panel-blackness-level = <0xc9e>;
				qcom,mdss-dsi-traffic-mode = "non_burst_sync_event";
				qcom,mdss-dsi-bllp-eof-power-mode;
				qcom,mdss-dsi-bllp-power-mode;
				qcom,mdss-dsi-lane-0-state;
				qcom,mdss-dsi-lane-1-state;
				qcom,mdss-dsi-lane-2-state;
				qcom,mdss-dsi-lane-3-state;
				qcom,mdss-dsi-t-clk-post = <0x04>;
				qcom,mdss-dsi-t-clk-pre = <0x1b>;
				qcom,mdss-dsi-dma-trigger = "trigger_sw";
				qcom,mdss-dsi-mdp-trigger = "none";
				qcom,mdss-dsi-reset-sequence = <0x01 0x00 0x00 0x00 0x01 0x00>;
				qcom,panel-ack-disabled;
				qcom,panel-supply-entries = <0x0d>;
				qcom,mdss-dsi-bl-pmic-control-type = "bl_ctrl_dcs";
				qcom,platform-reset-gpio = <0xffffffff 0x52 0x00>;
				phandle = <0x2e>;

				qcom,mdss-dsi-display-timings {

					timing@0 {
						qcom,mdss-dsi-panel-width = <0x280>;
						qcom,mdss-dsi-panel-height = <0x1e0>;
						qcom,mdss-dsi-h-front-porch = <0x08>;
						qcom,mdss-dsi-h-back-porch = <0x08>;
						qcom,mdss-dsi-h-pulse-width = <0x08>;
						qcom,mdss-dsi-h-sync-skew = <0x00>;
						qcom,mdss-dsi-v-back-porch = <0x06>;
						qcom,mdss-dsi-v-front-porch = <0x06>;
						qcom,mdss-dsi-v-pulse-width = <0x02>;
						qcom,mdss-dsi-h-left-border = <0x00>;
						qcom,mdss-dsi-h-right-border = <0x00>;
						qcom,mdss-dsi-v-top-border = <0x00>;
						qcom,mdss-dsi-v-bottom-border = <0x00>;
						qcom,mdss-dsi-panel-framerate = <0x3c>;
						qcom,mdss-dsi-panel-timings = <0x00 0x00 0x00>;
						qcom,mdss-dsi-on-command = [32 01 00 00 00 00 02 00 00];
						qcom,mdss-dsi-off-command = [22 01 00 00 00 00 02 00 00];
						qcom,mdss-dsi-on-command-state = "dsi_lp_mode";
						qcom,mdss-dsi-off-command-state = "dsi_lp_mode";
						qcom,mdss-dsi-h-sync-pulse = <0x00>;
					};
				};
			};
		};
	};

	fragment@13 {
		target = <0xffffffff>;

		__overlay__ {

			dsi_panel_pwr_supply_no_labibb {
				#address-cells = <0x01>;
				#size-cells = <0x00>;
				phandle = <0x0d>;

				qcom,panel-supply-entry@0 {
					reg = <0x00>;
					qcom,supply-name = "vddio";
					qcom,supply-min-voltage = <0x1b7740>;
					qcom,supply-max-voltage = <0x1b7740>;
					qcom,supply-enable-load = <0xf230>;
					qcom,supply-disable-load = <0x50>;
					qcom,supply-post-on-sleep = <0x14>;
				};
			};

			qcom,dsi-display-primary {
				compatible = "qcom,dsi-display";
				label = "primary";
				qcom,dsi-ctrl = <0xffffffff>;
				qcom,dsi-phy = <0xffffffff>;
				clocks = <0xffffffff 0x06 0xffffffff 0x09 0xffffffff 0x03 0xffffffff 0x08 0xffffffff 0x0d 0xffffffff 0x11>;
				clock-names = "mux_byte_clk0\0mux_pixel_clk0\0src_byte_clk0\0src_pixel_clk0\0shadow_byte_clk0\0shadow_pixel_clk0";
				pinctrl-names = "panel_active\0panel_suspend";
				pinctrl-0 = <0xffffffff 0xffffffff 0x0f>;
				pinctrl-1 = <0xffffffff 0xffffffff>;
				qcom,platform-te-gpio = <0xffffffff 0x51 0x00>;
				qcom,panel-te-source = <0x00>;
				qcom,platform-en-gpio = <0xffffffff 0x09 0x00>;
				qcom,mdp = <0xffffffff>;
				qcom,dsi-default-panel = <0x10>;
				phandle = <0x12>;
			};

			qcom,wb-display@0 {
				status = "disabled";
				compatible = "qcom,wb-display";
				cell-index = <0x00>;
				label = "wb_display";
				phandle = <0x2f>;
			};

			qcom,msm_notifier@0 {
				compatible = "qcom,msm-notifier";
				panel = <0x10 0x11>;
				phandle = <0x30>;
			};
		};
	};

	fragment@14 {
		target = <0xffffffff>;

		__overlay__ {
			connectors = <0x12>;
		};
	};

	fragment@15 {
		target = <0xffffffff>;

		__overlay__ {
			#address-cells = <0x02>;
			#size-cells = <0x00>;
			interrupt-controller;
			#interrupt-cells = <0x04>;

			qcom,pm7250b@2 {
				compatible = "qcom,spmi-pmic";
				reg = <0x02 0x00>;
				#address-cells = <0x02>;
				#size-cells = <0x00>;

				qcom,revid@100 {
					compatible = "qcom,qpnp-revid";
					reg = <0x100 0x100>;
					phandle = <0x13>;
				};

				qcom,power-on@800 {
					compatible = "qcom,qpnp-power-on";
					reg = <0x800 0x100>;
					qcom,log-kpd-event;
					phandle = <0x31>;
				};

				qcom,qpnp-smb5 {
					compatible = "qcom,qpnp-smb5";
					#address-cells = <0x01>;
					#size-cells = <0x01>;
					#cooling-cells = <0x02>;
					qcom,thermal-mitigation = <0x5265c0 0x44aa20 0x3d0900 0x3567e0 0x2dc6c0 0x2625a0 0x1e8480 0x16e360 0xf4240 0x7a120>;
					qcom,pmic-revid = <0x13>;
					qcom,hvdcp2-max-icl-ua = <0x1e8480>;
					qcom,hvdcp2-12v-max-icl-ua = <0x16e360>;
					status = "ok";
					io-channels = <0x14 0x08 0x14 0x07 0x14 0x09 0x14 0x06 0x14 0x4f 0x14 0x99 0x14 0x83>;
					io-channel-names = "usb_in_voltage\0usb_in_current\0chg_temp\0die_temp\0conn_temp\0sbux_res\0vph_voltage";
					qcom,batteryless-platform;
					qcom,sec-charger-config = <0x00>;
					qcom,auto-recharge-soc = <0x62>;
					qcom,step-charging-enable;
					qcom,sw-jeita-enable;
					qcom,charger-temp-max = <0x320>;
					qcom,suspend-input-on-debug-batt;
					dpdm-supply = <0xffffffff>;
					phandle = <0x21>;

					qcom,chgr@1000 {
						reg = <0x1000 0x100>;
						interrupts = <0x02 0x10 0x00 0x01 0x02 0x10 0x01 0x01 0x02 0x10 0x02 0x01 0x02 0x10 0x03 0x01 0x02 0x10 0x04 0x01 0x02 0x10 0x05 0x01 0x02 0x10 0x06 0x01 0x02 0x10 0x07 0x01>;
						interrupt-names = "chgr-error\0chg-state-change\0step-chg-state-change\0step-chg-soc-update-fail\0step-chg-soc-update-req\0fg-fvcal-qualified\0vph-alarm\0vph-drop-prechg";
					};

					qcom,dcdc@1100 {
						reg = <0x1100 0x100>;
						interrupts = <0x02 0x11 0x00 0x01 0x02 0x11 0x01 0x01 0x02 0x11 0x02 0x01 0x02 0x11 0x03 0x03 0x02 0x11 0x04 0x03 0x02 0x11 0x05 0x03 0x02 0x11 0x06 0x01 0x02 0x11 0x07 0x03>;
						interrupt-names = "otg-fail\0otg-oc-disable-sw\0otg-oc-hiccup\0bsm-active\0high-duty-cycle\0input-current-limiting\0concurrent-mode-disable\0switcher-power-ok";
					};

					qcom,batif@1200 {
						reg = <0x1200 0x100>;
						interrupts = <0x02 0x12 0x00 0x01 0x02 0x12 0x02 0x03 0x02 0x12 0x03 0x03 0x02 0x12 0x04 0x03 0x02 0x12 0x05 0x03 0x02 0x12 0x06 0x03 0x02 0x12 0x07 0x03>;
						interrupt-names = "bat-temp\0bat-ov\0bat-low\0bat-therm-or-id-missing\0bat-terminal-missing\0buck-oc\0vph-ov";
					};

					qcom,usb@1300 {
						reg = <0x1300 0x100>;
						interrupts = <0x02 0x13 0x00 0x03 0x02 0x13 0x01 0x03 0x02 0x13 0x02 0x03 0x02 0x13 0x03 0x03 0x02 0x13 0x04 0x03 0x02 0x13 0x05 0x03 0x02 0x13 0x06 0x01 0x02 0x13 0x07 0x01>;
						interrupt-names = "usbin-collapse\0usbin-vashdn\0usbin-uv\0usbin-ov\0usbin-plugin\0usbin-revi-change\0usbin-src-change\0usbin-icl-change";
					};

					qcom,dc@1400 {
						reg = <0x1400 0x100>;
						interrupts = <0x02 0x14 0x01 0x03 0x02 0x14 0x02 0x03 0x02 0x14 0x03 0x03 0x02 0x14 0x04 0x03 0x02 0x14 0x05 0x03 0x02 0x14 0x06 0x01 0x02 0x14 0x07 0x01>;
						interrupt-names = "dcin-vashdn\0dcin-uv\0dcin-ov\0dcin-plugin\0dcin-revi\0dcin-pon\0dcin-en";
					};

					qcom,typec@1500 {
						reg = <0x1500 0x100>;
						interrupts = <0x02 0x15 0x00 0x01 0x02 0x15 0x01 0x01 0x02 0x15 0x02 0x01 0x02 0x15 0x03 0x01 0x02 0x15 0x04 0x01 0x02 0x15 0x05 0x01 0x02 0x15 0x06 0x01 0x02 0x15 0x07 0x01>;
						interrupt-names = "typec-or-rid-detect-change\0typec-vpd-detect\0typec-cc-state-change\0typec-vconn-oc\0typec-vbus-change\0typec-attach-detach\0typec-legacy-cable-detect\0typec-try-snk-src-detect";
					};

					qcom,misc@1600 {
						reg = <0x1600 0x100>;
						interrupts = <0x02 0x16 0x00 0x01 0x02 0x16 0x01 0x01 0x02 0x16 0x02 0x01 0x02 0x16 0x03 0x01 0x02 0x16 0x04 0x03 0x02 0x16 0x05 0x01 0x02 0x16 0x06 0x01 0x02 0x16 0x07 0x01>;
						interrupt-names = "wdog-snarl\0wdog-bark\0aicl-fail\0aicl-done\0smb-en\0imp-trigger\0temp-change\0temp-change-smb";
					};

					qcom,chg-sdam@b000 {
						reg = <0xb000 0x100>;
					};

					qcom,smb5-vbus {
						regulator-name = "smb5-vbus";
						phandle = <0x15>;
					};

					qcom,smb5-vconn {
						regulator-name = "smb5-vconn";
						phandle = <0x16>;
					};
				};

				qcom,usb-pdphy@1700 {
					compatible = "qcom,qpnp-pdphy";
					reg = <0x1700 0x100>;
					interrupts = <0x02 0x17 0x00 0x01 0x02 0x17 0x01 0x01 0x02 0x17 0x02 0x01 0x02 0x17 0x03 0x01 0x02 0x17 0x04 0x01 0x02 0x17 0x05 0x01 0x02 0x17 0x06 0x01 0x02 0x17 0x07 0x01>;
					interrupt-names = "sig-tx\0sig-rx\0msg-tx\0msg-rx\0msg-tx-failed\0msg-tx-discarded\0msg-rx-discarded\0fr-swap";
					qcom,default-sink-caps = <0x1388 0xbb8 0x2328 0xbb8 0x2ee0 0x8ca>;
					vdd-pdphy-supply = <0xffffffff>;
					vbus-supply = <0x15>;
					vconn-supply = <0x16>;
					phandle = <0x20>;
				};

				qcom,temp-alarm@2400 {
					compatible = "qcom,spmi-temp-alarm";
					reg = <0x2400 0x100>;
					interrupts = <0x02 0x24 0x00 0x03>;
					io-channels = <0x14 0x06>;
					io-channel-names = "thermal";
					#thermal-sensor-cells = <0x00>;
					qcom,temperature-threshold-set = <0x01>;
					phandle = <0x18>;
				};

				qpnp,qg {
					compatible = "qcom,qpnp-qg";
					#address-cells = <0x01>;
					#size-cells = <0x01>;
					qcom,vbatt-cutoff-mv = <0xc80>;
					qcom,vbatt-low-mv = <0xce4>;
					qcom,vbatt-low-cold-mv = <0xe74>;
					qcom,vbatt-empty-mv = <0xbb8>;
					qcom,vbatt-empty-cold-mv = <0xbb8>;
					qcom,s3-entry-fifo-length = <0x02>;
					qcom,pmic-revid = <0x13>;
					status = "ok";
					io-channels = <0x14 0x4a 0x14 0x4b>;
					io-channel-names = "batt-therm\0batt-id";
					qcom,qg-iterm-ma = <0x96>;
					qcom,hold-soc-while-full;
					qcom,linearize-soc;
					qcom,cl-feedback-on;
					phandle = <0x32>;

					qcom,qgauge@4800 {
						status = "okay";
						reg = <0x4800 0x100>;
						interrupts = <0x02 0x48 0x00 0x03 0x02 0x48 0x01 0x03 0x02 0x48 0x02 0x01 0x02 0x48 0x03 0x01 0x02 0x48 0x04 0x01>;
						interrupt-names = "qg-batt-missing\0qg-vbat-low\0qg-vbat-empty\0qg-fifo-done\0qg-good-ocv";
					};

					qcom,qg-sdam@b100 {
						status = "okay";
						reg = <0xb100 0x100>;
					};
				};

				clock-controller@5b00 {
					compatible = "qcom,spmi-clkdiv";
					reg = <0x5b00 0x100>;
					#clock-cells = <0x01>;
					qcom,num-clkdivs = <0x01>;
					clock-output-names = "pm7250b_div_clk1";
					clocks = <0xffffffff 0x00>;
					clock-names = "xo";
					assigned-clocks = <0x17 0x01>;
					assigned-clock-rates = <0x124f800>;
					phandle = <0x17>;
				};

				pinctrl@c000 {
					compatible = "qcom,spmi-gpio";
					reg = <0xc000 0xc00>;
					interrupts = <0x02 0xc0 0x00 0x00 0x02 0xc1 0x00 0x00 0x02 0xc2 0x00 0x00 0x02 0xc3 0x00 0x00 0x02 0xc4 0x00 0x00 0x02 0xc5 0x00 0x00 0x02 0xc6 0x00 0x00 0x02 0xc7 0x00 0x00 0x02 0xc8 0x00 0x00 0x02 0xc9 0x00 0x00 0x02 0xca 0x00 0x00 0x02 0xcb 0x00 0x00>;
					interrupt-names = "pm7250b_gpio1\0pm7250b_gpio2\0pm7250b_gpio3\0pm7250b_gpio4\0pm7250b_gpio5\0pm7250b_gpio6\0pm7250b_gpio7\0pm7250b_gpio8\0pm7250b_gpio9\0pm7250b_gpio10\0pm7250b_gpio11\0pm7250b_gpio12";
					gpio-controller;
					#gpio-cells = <0x02>;
					phandle = <0x0e>;

					disp_lcd_bias_en {

						disp_lcd_bias_en_default {
							pins = "gpio5";
							function = "func1";
							input-disable;
							output-enable;
							bias-disable;
							power-source = <0x00>;
							qcom,drive-strength = <0x02>;
							phandle = <0x0f>;
						};
					};
				};

				vadc@3100 {
					compatible = "qcom,spmi-adc5";
					reg = <0x3100 0x100>;
					reg-names = "adc5-usr-base";
					#address-cells = <0x01>;
					#size-cells = <0x00>;
					interrupts = <0x02 0x31 0x00 0x01>;
					interrupt-names = "eoc-int-en-set";
					qcom,adc-vdd-reference = <0x753>;
					#io-channel-cells = <0x01>;
					io-channel-ranges;
					phandle = <0x14>;

					ref_gnd@0 {
						reg = <0x00>;
						label = "ref_gnd";
						qcom,pre-scaling = <0x01 0x01>;
					};

					vref_1p25@1 {
						reg = <0x01>;
						label = "vref_1p25";
						qcom,pre-scaling = <0x01 0x01>;
					};

					die_temp@2 {
						reg = <0x06>;
						label = "die_temp";
						qcom,pre-scaling = <0x01 0x01>;
					};

					vph_pwr@83 {
						reg = <0x83>;
						label = "vph_pwr";
						qcom,pre-scaling = <0x01 0x03>;
					};

					vbat_sns@84 {
						reg = <0x84>;
						label = "vbat_sns";
						qcom,pre-scaling = <0x01 0x03>;
					};

					usb_in_i_uv@7 {
						reg = <0x07>;
						label = "usb_in_i_uv";
						qcom,pre-scaling = <0x01 0x01>;
					};

					usb_in_v_div_16@8 {
						reg = <0x08>;
						label = "usb_in_v_div_16";
						qcom,pre-scaling = <0x01 0x10>;
					};

					chg_temp@9 {
						reg = <0x09>;
						label = "chg_temp";
						qcom,pre-scaling = <0x01 0x01>;
					};

					bat_therm@4a {
						reg = <0x4a>;
						label = "bat_therm";
						qcom,ratiometric;
						qcom,hw-settle-time = <0xc8>;
						qcom,pre-scaling = <0x01 0x01>;
					};

					bat_therm_30k@2a {
						reg = <0x2a>;
						label = "bat_therm_30k";
						qcom,ratiometric;
						qcom,hw-settle-time = <0xc8>;
						qcom,pre-scaling = <0x01 0x01>;
					};

					bat_therm_400k@6a {
						reg = <0x6a>;
						label = "bat_therm_400k";
						qcom,ratiometric;
						qcom,hw-settle-time = <0xc8>;
						qcom,pre-scaling = <0x01 0x01>;
					};

					bat_id@4b {
						reg = <0x4b>;
						label = "bat_id";
						qcom,ratiometric;
						qcom,hw-settle-time = <0xc8>;
						qcom,pre-scaling = <0x01 0x01>;
					};

					smb1390_therm@e {
						reg = <0x0e>;
						label = "smb1390_therm";
						qcom,hw-settle-time = <0xc8>;
						qcom,pre-scaling = <0x01 0x01>;
					};

					chg_sbux@99 {
						reg = <0x99>;
						label = "chg_sbux";
						qcom,pre-scaling = <0x01 0x03>;
					};

					mid_chg_div6@1e {
						reg = <0x1e>;
						label = "chg_mid";
						qcom,pre-scaling = <0x01 0x06>;
					};

					v_i_int_ext@b0 {
						reg = <0xb0>;
						label = "v_i_int_vbat_vdata";
						qcom,pre-scaling = <0x01 0x01>;
					};

					v_i_parallel@b0 {
						reg = <0xb4>;
						label = "v_i_parallel_vbat_vdata";
						qcom,pre-scaling = <0x01 0x01>;
					};

					charger_skin_therm@4d {
						reg = <0x4d>;
						label = "charger_skin_therm";
						qcom,ratiometric;
						qcom,hw-settle-time = <0xc8>;
						qcom,pre-scaling = <0x01 0x01>;
					};

					conn_therm@4f {
						reg = <0x4f>;
						label = "conn_therm";
						qcom,ratiometric;
						qcom,hw-settle-time = <0xc8>;
						qcom,pre-scaling = <0x01 0x01>;
					};
				};

				adc_tm@3500 {
					compatible = "qcom,adc-tm5";
					reg = <0x3500 0x100>;
					interrupts = <0x02 0x35 0x00 0x01>;
					interrupt-names = "thr-int-en";
					#address-cells = <0x01>;
					#size-cells = <0x00>;
					#thermal-sensor-cells = <0x01>;
					io-channels = <0x14 0x4d 0x14 0x4f>;
					phandle = <0x1b>;

					charger_skin_therm@4d {
						reg = <0x4d>;
						qcom,ratiometric;
						qcom,hw-settle-time = <0xc8>;
					};

					conn_therm@4f {
						reg = <0x4f>;
						qcom,ratiometric;
						qcom,hw-settle-time = <0xc8>;
					};
				};

				bcl@1d00 {
					compatible = "qcom,bcl-v5";
					reg = <0x1d00 0x100>;
					interrupts = <0x02 0x1d 0x00 0x00 0x02 0x1d 0x01 0x00 0x02 0x1d 0x02 0x00>;
					interrupt-names = "bcl-lvl0\0bcl-lvl1\0bcl-lvl2";
					#thermal-sensor-cells = <0x01>;
					phandle = <0x19>;
				};

				bcl-soc {
					compatible = "qcom,msm-bcl-soc";
					#thermal-sensor-cells = <0x00>;
					phandle = <0x1a>;
				};
			};

			qcom,pm7250b@3 {
				compatible = "qcom,spmi-pmic";
				reg = <0x03 0x00>;
				#address-cells = <0x02>;
				#size-cells = <0x00>;

				qcom,vibrator@5300 {
					compatible = "qcom,qpnp-vibrator-ldo";
					reg = <0x5300 0x100>;
					qcom,vib-ldo-volt-uv = <0x2dc6c0>;
					qcom,disable-overdrive;
					phandle = <0x33>;
				};
			};
		};
	};

	fragment@16 {
		target = <0xffffffff>;

		__overlay__ {

			pm7250b-tz {
				polling-delay-passive = <0x64>;
				polling-delay = <0x00>;
				thermal-governor = "step_wise";
				thermal-sensors = <0x18>;
				wake-capable-sensor;
				phandle = <0x34>;

				trips {

					trip0 {
						temperature = <0x17318>;
						hysteresis = <0x00>;
						type = "passive";
						phandle = <0x35>;
					};

					trip1 {
						temperature = <0x1c138>;
						hysteresis = <0x00>;
						type = "passive";
						phandle = <0x36>;
					};

					trip2 {
						temperature = <0x23668>;
						hysteresis = <0x00>;
						type = "passive";
					};
				};
			};

			pm7250b-ibat-lvl0 {
				polling-delay-passive = <0x00>;
				polling-delay = <0x00>;
				thermal-governor = "step_wise";
				thermal-sensors = <0x19 0x00>;
				wake-capable-sensor;

				trips {

					ibat-lvl0 {
						temperature = <0x157c>;
						hysteresis = <0xc8>;
						type = "passive";
						phandle = <0x37>;
					};
				};
			};

			pm7250b-ibat-lvl1 {
				polling-delay-passive = <0x00>;
				polling-delay = <0x00>;
				thermal-governor = "step_wise";
				thermal-sensors = <0x19 0x01>;
				wake-capable-sensor;

				trips {

					ibat-lvl1 {
						temperature = <0x1770>;
						hysteresis = <0xc8>;
						type = "passive";
						phandle = <0x38>;
					};
				};
			};

			pm7250b-vbat-lvl0 {
				polling-delay-passive = <0x00>;
				polling-delay = <0x00>;
				thermal-governor = "low_limits_cap";
				thermal-sensors = <0x19 0x02>;
				wake-capable-sensor;
				tracks-low;

				trips {

					vbat-lvl0 {
						temperature = <0xbb8>;
						hysteresis = <0xc8>;
						type = "passive";
						phandle = <0x39>;
					};
				};
			};

			pm7250b-vbat-lvl1 {
				polling-delay-passive = <0x00>;
				polling-delay = <0x00>;
				thermal-governor = "low_limits_cap";
				thermal-sensors = <0x19 0x03>;
				wake-capable-sensor;
				tracks-low;

				trips {

					vbat-lvl1 {
						temperature = <0xaf0>;
						hysteresis = <0xc8>;
						type = "passive";
						phandle = <0x3a>;
					};
				};
			};

			pm7250b-vbat-lvl2 {
				polling-delay-passive = <0x00>;
				polling-delay = <0x00>;
				thermal-governor = "low_limits_cap";
				thermal-sensors = <0x19 0x04>;
				wake-capable-sensor;
				tracks-low;

				trips {

					vbat-lvl2 {
						temperature = <0xa28>;
						hysteresis = <0xc8>;
						type = "passive";
						phandle = <0x3b>;
					};
				};
			};

			pm7250b-bcl-lvl0 {
				polling-delay-passive = <0x64>;
				polling-delay = <0x00>;
				thermal-governor = "step_wise";
				thermal-sensors = <0x19 0x05>;
				wake-capable-sensor;

				trips {

					b-bcl-lvl0 {
						temperature = <0x01>;
						hysteresis = <0x01>;
						type = "passive";
						phandle = <0x3c>;
					};
				};
			};

			pm7250b-bcl-lvl1 {
				polling-delay-passive = <0x64>;
				polling-delay = <0x00>;
				thermal-governor = "step_wise";
				thermal-sensors = <0x19 0x06>;
				wake-capable-sensor;

				trips {

					b-bcl-lvl1 {
						temperature = <0x01>;
						hysteresis = <0x01>;
						type = "passive";
						phandle = <0x3d>;
					};
				};
			};

			pm7250b-bcl-lvl2 {
				polling-delay-passive = <0x64>;
				polling-delay = <0x00>;
				thermal-governor = "step_wise";
				thermal-sensors = <0x19 0x07>;
				wake-capable-sensor;

				trips {

					b-bcl-lvl2 {
						temperature = <0x01>;
						hysteresis = <0x01>;
						type = "passive";
						phandle = <0x3e>;
					};
				};
			};

			soc {
				polling-delay-passive = <0x64>;
				polling-delay = <0x00>;
				thermal-governor = "low_limits_cap";
				thermal-sensors = <0x1a>;
				wake-capable-sensor;
				tracks-low;

				trips {

					soc-trip {
						temperature = <0x0a>;
						hysteresis = <0x00>;
						type = "passive";
						phandle = <0x3f>;
					};
				};
			};
		};
	};

	fragment@17 {
		target = <0xffffffff>;

		__overlay__ {

			charger-therm-usr {
				polling-delay-passive = <0x00>;
				polling-delay = <0x00>;
				thermal-governor = "user_space";
				thermal-sensors = <0x1b 0x4d>;
				wake-capable-sensor;

				trips {

					active-config0 {
						temperature = <0x1e848>;
						hysteresis = <0x3e8>;
						type = "passive";
					};
				};
			};

			conn-therm-usr {
				polling-delay-passive = <0x00>;
				polling-delay = <0x00>;
				thermal-governor = "user_space";
				thermal-sensors = <0x1b 0x4f>;
				wake-capable-sensor;

				trips {

					active-config0 {
						temperature = <0x1e848>;
						hysteresis = <0x3e8>;
						type = "passive";
					};
				};
			};
		};
	};

	fragment@18 {
		target = <0xffffffff>;

		__overlay__ {

			eldo9_pin {

				gpio@c000 {
					pins = "gpio1";
					function = "normal";
					qcom,drive-strength = <0x02>;
					power-source = <0x00>;
					bias-disable;
					output-high;
					phandle = <0x1c>;
				};
			};
		};
	};

	fragment@19 {
		target = <0xffffffff>;

		__overlay__ {

			vdda_usb_ss_dp_core {
				compatible = "regulator-fixed";
				regulator-name = "vdd_supply";
				regulator-min-microvolt = <0xd6d80>;
				regulator-max-microvolt = <0xd6d80>;
				enable-active-high;
				gpio = <0xffffffff 0x01 0x00>;
				pinctrl-names = "default";
				pinctrl-0 = <0x1c>;
				phandle = <0x1d>;
			};
		};
	};

	fragment@20 {
		target = <0xffffffff>;

		__overlay__ {
			vdd-supply = <0xffffffff>;
			qcom,vdd-voltage-level = <0x2d2a80 0x2d2a80>;
			qcom,vdd-current-level = <0x00 0x8b290>;
			vdd-io-supply = <0xffffffff>;
			qcom,vdd-io-always-on;
			qcom,vdd-io-lpm-sup;
			qcom,vdd-io-voltage-level = <0x1b7740 0x1b7740>;
			qcom,vdd-io-current-level = <0x00 0x4f588>;
			pinctrl-names = "active\0sleep";
			pinctrl-0 = <0xffffffff 0xffffffff 0xffffffff 0xffffffff>;
			pinctrl-1 = <0xffffffff 0xffffffff 0xffffffff 0xffffffff>;
			status = "ok";
		};
	};

	fragment@21 {
		target = <0xffffffff>;

		__overlay__ {
			vdd-supply = <0xffffffff>;
			qcom,vdd-voltage-level = <0x2d2a80 0x2d2a80>;
			qcom,vdd-current-level = <0x00 0xc3500>;
			vdd-io-supply = <0xffffffff>;
			qcom,vdd-io-voltage-level = <0x1b7740 0x2d2a80>;
			qcom,vdd-io-current-level = <0x00 0x55f0>;
			vdd-io-bias-supply = <0xffffffff>;
			qcom,vdd-io-bias-voltage-level = <0x132a40 0x132a40>;
			qcom,vdd-io-bias-current-level = <0x00 0x1770>;
			pinctrl-names = "active\0sleep";
			pinctrl-0 = <0xffffffff 0xffffffff 0xffffffff 0xffffffff>;
			pinctrl-1 = <0xffffffff 0xffffffff 0xffffffff 0xffffffff>;
			cd-gpios = <0xffffffff 0x58 0x01>;
			status = "ok";
		};
	};

	fragment@22 {
		target = <0xffffffff>;

		__overlay__ {
			compatible = "qcom,ufs-phy-qmp-v4";
			vdda-phy-supply = <0xffffffff>;
			vdda-pll-supply = <0xffffffff>;
			vdda-phy-max-microamp = <0x14ec4>;
			vdda-pll-max-microamp = <0x477c>;
			status = "ok";
		};
	};

	fragment@23 {
		target = <0xffffffff>;

		__overlay__ {
			vdd-hba-supply = <0xffffffff>;
			vdd-hba-fixed-regulator;
			vcc-supply = <0xffffffff>;
			vcc-voltage-level = <0x2d0370 0x2d2a80>;
			vccq2-supply = <0xffffffff>;
			vccq2-voltage-level = <0x1b7740 0x1b7740>;
			vcc-max-microamp = "\0\f5";
			vccq2-max-microamp = "\0\f5";
			vccq2-pwr-collapse-sup;
			qcom,vddp-ref-clk-supply = <0xffffffff>;
			qcom,vddp-ref-clk-max-microamp = <0x64>;
			qcom,vddp-ref-clk-min-uV = <0x12cc80>;
			qcom,vddp-ref-clk-max-uV = <0x12cc80>;
			status = "ok";
		};
	};

	fragment@24 {
		target = <0xffffffff>;

		__overlay__ {
			vdd-supply = <0x1d>;
		};
	};

	fragment@25 {
		target = <0xffffffff>;

		__overlay__ {
			pinctrl-0 = <0xffffffff 0xffffffff 0x1e>;

			rf_pa1_therm {
				reg = <0x55>;
				label = "rf_pa1_therm";
				qcom,ratiometric;
				qcom,hw-settle-time = <0xc8>;
				qcom,pre-scaling = <0x01 0x01>;
			};
		};
	};

	fragment@26 {
		target = <0xffffffff>;

		__overlay__ {
			io-channels = <0xffffffff 0x4d 0xffffffff 0x4e 0xffffffff 0x4c 0xffffffff 0x55>;

			rf_pa1_therm {
				reg = <0x55>;
				qcom,ratiometric;
				qcom,hw-settle-time = <0xc8>;
			};
		};
	};

	fragment@27 {
		target = <0xffffffff>;

		__overlay__ {

			rf-pa1-therm-usr {
				polling-delay-passive = <0x00>;
				polling-delay = <0x00>;
				thermal-governor = "user_space";
				thermal-sensors = <0xffffffff 0x55>;
				wake-capable-sensor;

				trips {

					active-config0 {
						temperature = <0x1e848>;
						hysteresis = <0x3e8>;
						type = "passive";
					};
				};
			};
		};
	};

	fragment@28 {
		target = <0xffffffff>;

		__overlay__ {

			rf_pa1_therm {

				rf_pa1_therm_default {
					pins = "gpio7";
					bias-high-impedance;
					phandle = <0x1e>;
				};
			};

			key_vol_up {

				key_vol_up_default {
					pins = "gpio5";
					function = "normal";
					input-enable;
					bias-pull-up;
					power-source = <0x00>;
					phandle = <0x1f>;
				};
			};
		};
	};

	fragment@29 {
		target = <0xffffffff>;

		__overlay__ {

			gpio_keys {
				compatible = "gpio-keys";
				label = "gpio-keys";
				pinctrl-names = "default";
				pinctrl-0 = <0x1f>;

				vol_up {
					label = "volume_up";
					gpios = <0xffffffff 0x05 0x01>;
					linux,input-type = <0x01>;
					linux,code = <0x73>;
					linux,can-disable;
					debounce-interval = <0x0f>;
					gpio-key,wakeup;
				};
			};
		};
	};

	fragment@30 {
		target = <0xffffffff>;

		__overlay__ {
			status = "disabled";
		};
	};

	fragment@31 {
		target = <0xffffffff>;

		__overlay__ {
			status = "disabled";
		};
	};

	fragment@32 {
		target = <0xffffffff>;

		__overlay__ {
			status = "okay";
		};
	};

	fragment@33 {
		target = <0xffffffff>;

		__overlay__ {
			status = "okay";
			qcom,i2c-touch-active = "novatek,NVT-ts";

			novatek@62 {
				compatible = "novatek,NVT-ts";
				reg = <0x62>;
				status = "ok";
				interrupt-parent = <0xffffffff>;
				interrupts = <0x50 0x2008>;
				pinctrl-names = "pmx_ts_active\0pmx_ts_suspend\0pmx_ts_release";
				pinctrl-0 = <0xffffffff 0xffffffff>;
				pinctrl-1 = <0xffffffff 0xffffffff>;
				pinctrl-2 = <0xffffffff>;
				novatek,reset-gpio = <0xffffffff 0x56 0x00>;
				novatek,irq-gpio = <0xffffffff 0x50 0x2008>;
				panel = <0x10>;
			};
		};
	};

	fragment@34 {
		target = <0xffffffff>;

		__overlay__ {
			extcon = <0x20 0x21 0xffffffff>;
		};
	};

	__symbols__ {
		tx_macro = "/fragment@0/__overlay__/tx-macro@a620000";
		rx_macro = "/fragment@0/__overlay__/rx-macro@a600000";
		swr1 = "/fragment@0/__overlay__/rx-macro@a600000/rx_swr_master";
		wcd937x_rx_slave = "/fragment@0/__overlay__/rx-macro@a600000/rx_swr_master/wcd937x-rx-slave";
		va_macro = "/fragment@0/__overlay__/va-macro@a730000";
		swr0 = "/fragment@0/__overlay__/va-macro@a730000/va_swr_master";
		wcd937x_tx_slave = "/fragment@0/__overlay__/va-macro@a730000/va_swr_master/wcd937x-tx-slave";
		wcd937x_codec = "/fragment@0/__overlay__/wcd937x-codec";
		wsa881x_i2c_e = "/fragment@2/__overlay__/wsa881x-i2c-codec@e";
		wsa881x_i2c_44 = "/fragment@2/__overlay__/wsa881x-i2c-codec@44";
		fsa4480 = "/fragment@2/__overlay__/fsa4480@42";
		wcd937x_rst_gpio = "/fragment@3/__overlay__/msm_cdc_pinctrl@92";
		wsa881x_analog_reset_gpio = "/fragment@3/__overlay__/msm_cdc_pinctrl@106";
		wsa881x_analog_clk = "/fragment@3/__overlay__/wsa_ana_clk";
		clock_audio_rx_1 = "/fragment@3/__overlay__/rx_core_clk";
		clock_audio_rx_2 = "/fragment@3/__overlay__/rx_npl_clk";
		clock_audio_tx_1 = "/fragment@3/__overlay__/tx_core_clk";
		clock_audio_tx_2 = "/fragment@3/__overlay__/tx_npl_clk";
		clock_audio_va_1 = "/fragment@3/__overlay__/va_core_clk";
		clock_audio_va_2 = "/fragment@3/__overlay__/va_npl_clk";
		dsi_td4330_truly_v2_cmd = "/fragment@6/__overlay__/qcom,mdss_dsi_td4330_truly_v2_cmd";
		dsi_td4330_truly_v2_video = "/fragment@7/__overlay__/qcom,mdss_dsi_td4330_truly_v2_video";
		dsi_k7_38_0c_0a_video = "/fragment@8/__overlay__/qcom,mdss_dsi_panel_k7_38_0c_0a_fhdp_video";
		dsi_k7_38_0c_0b_video = "/fragment@9/__overlay__/qcom,mdss_dsi_panel_k7_38_0c_0b_fhdp_video";
		dsi_nt36672e_fhd_plus_90hz_video = "/fragment@10/__overlay__/qcom,mdss_dsi_nt36672e_fhd_plus_90hz_video";
		dsi_nt36672e_fhd_plus_120hz_video = "/fragment@11/__overlay__/qcom,mdss_dsi_nt36672e_fhd_plus_120hz_video";
		dsi_sim_vid = "/fragment@12/__overlay__/qcom,mdss_dsi_sim_video";
		dsi_panel_pwr_supply_no_labibb = "/fragment@13/__overlay__/dsi_panel_pwr_supply_no_labibb";
		sde_dsi = "/fragment@13/__overlay__/qcom,dsi-display-primary";
		sde_wb = "/fragment@13/__overlay__/qcom,wb-display@0";
		msm_notifier = "/fragment@13/__overlay__/qcom,msm_notifier@0";
		pm7250b_revid = "/fragment@15/__overlay__/qcom,pm7250b@2/qcom,revid@100";
		pm7250b_pon = "/fragment@15/__overlay__/qcom,pm7250b@2/qcom,power-on@800";
		pm7250b_charger = "/fragment@15/__overlay__/qcom,pm7250b@2/qcom,qpnp-smb5";
		smb5_vbus = "/fragment@15/__overlay__/qcom,pm7250b@2/qcom,qpnp-smb5/qcom,smb5-vbus";
		smb5_vconn = "/fragment@15/__overlay__/qcom,pm7250b@2/qcom,qpnp-smb5/qcom,smb5-vconn";
		pm7250b_pdphy = "/fragment@15/__overlay__/qcom,pm7250b@2/qcom,usb-pdphy@1700";
		pm7250b_tz = "/fragment@15/__overlay__/qcom,pm7250b@2/qcom,temp-alarm@2400";
		pm7250b_qg = "/fragment@15/__overlay__/qcom,pm7250b@2/qpnp,qg";
		pm7250b_clkdiv = "/fragment@15/__overlay__/qcom,pm7250b@2/clock-controller@5b00";
		pm7250b_gpios = "/fragment@15/__overlay__/qcom,pm7250b@2/pinctrl@c000";
		disp_lcd_bias_en_default = "/fragment@15/__overlay__/qcom,pm7250b@2/pinctrl@c000/disp_lcd_bias_en/disp_lcd_bias_en_default";
		pm7250b_vadc = "/fragment@15/__overlay__/qcom,pm7250b@2/vadc@3100";
		pm7250b_adc_tm = "/fragment@15/__overlay__/qcom,pm7250b@2/adc_tm@3500";
		pm7250b_bcl = "/fragment@15/__overlay__/qcom,pm7250b@2/bcl@1d00";
		bcl_soc = "/fragment@15/__overlay__/qcom,pm7250b@2/bcl-soc";
		pm7250b_vib = "/fragment@15/__overlay__/qcom,pm7250b@3/qcom,vibrator@5300";
		pm7250b_temp_alarm = "/fragment@16/__overlay__/pm7250b-tz";
		pm7250b_trip0 = "/fragment@16/__overlay__/pm7250b-tz/trips/trip0";
		pm7250b_trip1 = "/fragment@16/__overlay__/pm7250b-tz/trips/trip1";
		ibat_lvl0 = "/fragment@16/__overlay__/pm7250b-ibat-lvl0/trips/ibat-lvl0";
		ibat_lvl1 = "/fragment@16/__overlay__/pm7250b-ibat-lvl1/trips/ibat-lvl1";
		vbat_lvl0 = "/fragment@16/__overlay__/pm7250b-vbat-lvl0/trips/vbat-lvl0";
		vbat_lvl1 = "/fragment@16/__overlay__/pm7250b-vbat-lvl1/trips/vbat-lvl1";
		vbat_lvl2 = "/fragment@16/__overlay__/pm7250b-vbat-lvl2/trips/vbat-lvl2";
		b_bcl_lvl0 = "/fragment@16/__overlay__/pm7250b-bcl-lvl0/trips/b-bcl-lvl0";
		b_bcl_lvl1 = "/fragment@16/__overlay__/pm7250b-bcl-lvl1/trips/b-bcl-lvl1";
		b_bcl_lvl2 = "/fragment@16/__overlay__/pm7250b-bcl-lvl2/trips/b-bcl-lvl2";
		soc_trip = "/fragment@16/__overlay__/soc/trips/soc-trip";
		usb_eldo9 = "/fragment@18/__overlay__/eldo9_pin/gpio@c000";
		vdda_usb_ss_dp_core = "/fragment@19/__overlay__/vdda_usb_ss_dp_core";
		rf_pa1_therm_default = "/fragment@28/__overlay__/rf_pa1_therm/rf_pa1_therm_default";
		key_vol_up_default = "/fragment@28/__overlay__/key_vol_up/key_vol_up_default";
	};

	__fixups__ {
		bolero = "/fragment@0:target:0\0/fragment@1/__overlay__:asoc-codec:4\0/fragment@1/__overlay__:qcom,msm_audio_ssr_devs:8";
		rx_swr_gpios = "/fragment@0/__overlay__/rx-macro@a600000:qcom,rx-swr-gpios:0";
		lpass_audio_hw_vote = "/fragment@0/__overlay__/rx-macro@a600000/rx_swr_master:clocks:0\0/fragment@0/__overlay__/va-macro@a730000:clocks:0\0/fragment@0/__overlay__/va-macro@a730000/va_swr_master:clocks:0";
		va_swr_gpios = "/fragment@0/__overlay__/va-macro@a730000:qcom,va-swr-gpios:0";
		L9A = "/fragment@0/__overlay__/wcd937x-codec:cdc-vdd-rxtx-supply:0\0/fragment@0/__overlay__/wcd937x-codec:cdc-vddpx-supply:0";
		L14A = "/fragment@0/__overlay__/wcd937x-codec:cdc-vdd-buck-supply:0";
		bengal_snd = "/fragment@1:target:0";
		cdc_dmic01_gpios = "/fragment@1/__overlay__:qcom,cdc-dmic01-gpios:0";
		cdc_dmic23_gpios = "/fragment@1/__overlay__:qcom,cdc-dmic23-gpios:0";
		adsp_variant = "/fragment@1/__overlay__:nvmem-cells:0\0/fragment@5/__overlay__:nvmem-cells:0";
		stub_codec = "/fragment@1/__overlay__:asoc-codec:0";
		audio_apr = "/fragment@1/__overlay__:qcom,msm_audio_ssr_devs:0";
		q6core = "/fragment@1/__overlay__:qcom,msm_audio_ssr_devs:4";
		lpi_tlmm = "/fragment@1/__overlay__:qcom,msm_audio_ssr_devs:12";
		qupv3_se1_i2c = "/fragment@2:target:0";
		wsa881x_analog_clk_gpio = "/fragment@2/__overlay__/wsa881x-i2c-codec@e:qcom,wsa-analog-clk-gpio:0";
		tlmm = "/fragment@2/__overlay__/aw87xxx_pa_5B@5B:reset-gpio:0\0/fragment@2/__overlay__/aw87xxx_pa_58@58:reset-gpio:0\0/fragment@8/__overlay__/qcom,mdss_dsi_panel_k7_38_0c_0a_fhdp_video:qcom,esd-err-irq-gpio:0\0/fragment@8/__overlay__/qcom,mdss_dsi_panel_k7_38_0c_0a_fhdp_video:qcom,platform-reset-gpio:0\0/fragment@9/__overlay__/qcom,mdss_dsi_panel_k7_38_0c_0b_fhdp_video:qcom,esd-err-irq-gpio:0\0/fragment@9/__overlay__/qcom,mdss_dsi_panel_k7_38_0c_0b_fhdp_video:qcom,platform-reset-gpio:0\0/fragment@10/__overlay__/qcom,mdss_dsi_nt36672e_fhd_plus_90hz_video:qcom,platform-reset-gpio:0\0/fragment@12/__overlay__/qcom,mdss_dsi_sim_video:qcom,platform-reset-gpio:0\0/fragment@13/__overlay__/qcom,dsi-display-primary:qcom,platform-te-gpio:0\0/fragment@21/__overlay__:cd-gpios:0\0/fragment@33/__overlay__/novatek@62:interrupt-parent:0\0/fragment@33/__overlay__/novatek@62:novatek,reset-gpio:0\0/fragment@33/__overlay__/novatek@62:novatek,irq-gpio:0";
		soc = "/fragment@3:target:0\0/fragment@13:target:0\0/fragment@19:target:0\0/fragment@29:target:0";
		wcd937x_reset_active = "/fragment@3/__overlay__/msm_cdc_pinctrl@92:pinctrl-0:0";
		wcd937x_reset_sleep = "/fragment@3/__overlay__/msm_cdc_pinctrl@92:pinctrl-1:0";
		spkr_1_sd_n_active = "/fragment@3/__overlay__/msm_cdc_pinctrl@106:pinctrl-0:0";
		spkr_1_sd_n_sleep = "/fragment@3/__overlay__/msm_cdc_pinctrl@106:pinctrl-1:0";
		va_cdc_dma_0_tx = "/fragment@4:target:0";
		adsp_loader = "/fragment@5:target:0";
		mdss_mdp = "/fragment@6:target:0\0/fragment@7:target:0\0/fragment@8:target:0\0/fragment@9:target:0\0/fragment@10:target:0\0/fragment@11:target:0\0/fragment@12:target:0\0/fragment@13/__overlay__/qcom,dsi-display-primary:qcom,mdp:0\0/fragment@14:target:0";
		pm6125_gpios = "/fragment@8/__overlay__/qcom,mdss_dsi_panel_k7_38_0c_0a_fhdp_video:qcom,platform-en-gpio:0\0/fragment@9/__overlay__/qcom,mdss_dsi_panel_k7_38_0c_0b_fhdp_video:qcom,platform-en-gpio:0\0/fragment@13/__overlay__/qcom,dsi-display-primary:qcom,platform-en-gpio:0\0/fragment@18:target:0\0/fragment@19/__overlay__/vdda_usb_ss_dp_core:gpio:0\0/fragment@28:target:0\0/fragment@29/__overlay__/gpio_keys/vol_up:gpios:0";
		pm6125_pwm = "/fragment@10/__overlay__/qcom,mdss_dsi_nt36672e_fhd_plus_90hz_video:pwms:0\0/fragment@32:target:0";
		mdss_dsi0 = "/fragment@13/__overlay__/qcom,dsi-display-primary:qcom,dsi-ctrl:0";
		mdss_dsi_phy0 = "/fragment@13/__overlay__/qcom,dsi-display-primary:qcom,dsi-phy:0";
		mdss_dsi0_pll = "/fragment@13/__overlay__/qcom,dsi-display-primary:clocks:0\0/fragment@13/__overlay__/qcom,dsi-display-primary:clocks:8\0/fragment@13/__overlay__/qcom,dsi-display-primary:clocks:16\0/fragment@13/__overlay__/qcom,dsi-display-primary:clocks:24\0/fragment@13/__overlay__/qcom,dsi-display-primary:clocks:32\0/fragment@13/__overlay__/qcom,dsi-display-primary:clocks:40";
		sde_dsi_active = "/fragment@13/__overlay__/qcom,dsi-display-primary:pinctrl-0:0";
		sde_te_active = "/fragment@13/__overlay__/qcom,dsi-display-primary:pinctrl-0:4";
		sde_dsi_suspend = "/fragment@13/__overlay__/qcom,dsi-display-primary:pinctrl-1:0";
		sde_te_suspend = "/fragment@13/__overlay__/qcom,dsi-display-primary:pinctrl-1:4";
		spmi_bus = "/fragment@15:target:0";
		usb2_phy0 = "/fragment@15/__overlay__/qcom,pm7250b@2/qcom,qpnp-smb5:dpdm-supply:0";
		L15A = "/fragment@15/__overlay__/qcom,pm7250b@2/qcom,usb-pdphy@1700:vdd-pdphy-supply:0";
		rpmcc = "/fragment@15/__overlay__/qcom,pm7250b@2/clock-controller@5b00:clocks:0";
		thermal_zones = "/fragment@16:target:0\0/fragment@17:target:0\0/fragment@27:target:0";
		sdhc_1 = "/fragment@20:target:0";
		L24A = "/fragment@20/__overlay__:vdd-supply:0\0/fragment@23/__overlay__:vcc-supply:0";
		L11A = "/fragment@20/__overlay__:vdd-io-supply:0\0/fragment@23/__overlay__:vccq2-supply:0";
		sdc1_clk_on = "/fragment@20/__overlay__:pinctrl-0:0";
		sdc1_cmd_on = "/fragment@20/__overlay__:pinctrl-0:4";
		sdc1_data_on = "/fragment@20/__overlay__:pinctrl-0:8";
		sdc1_rclk_on = "/fragment@20/__overlay__:pinctrl-0:12";
		sdc1_clk_off = "/fragment@20/__overlay__:pinctrl-1:0";
		sdc1_cmd_off = "/fragment@20/__overlay__:pinctrl-1:4";
		sdc1_data_off = "/fragment@20/__overlay__:pinctrl-1:8";
		sdc1_rclk_off = "/fragment@20/__overlay__:pinctrl-1:12";
		sdhc_2 = "/fragment@21:target:0";
		L22A = "/fragment@21/__overlay__:vdd-supply:0";
		L5A = "/fragment@21/__overlay__:vdd-io-supply:0";
		L7A = "/fragment@21/__overlay__:vdd-io-bias-supply:0";
		sdc2_clk_on = "/fragment@21/__overlay__:pinctrl-0:0";
		sdc2_cmd_on = "/fragment@21/__overlay__:pinctrl-0:4";
		sdc2_data_on = "/fragment@21/__overlay__:pinctrl-0:8";
		sdc2_cd_on = "/fragment@21/__overlay__:pinctrl-0:12";
		sdc2_clk_off = "/fragment@21/__overlay__:pinctrl-1:0";
		sdc2_cmd_off = "/fragment@21/__overlay__:pinctrl-1:4";
		sdc2_data_off = "/fragment@21/__overlay__:pinctrl-1:8";
		sdc2_cd_off = "/fragment@21/__overlay__:pinctrl-1:12";
		ufsphy_mem = "/fragment@22:target:0";
		L4A = "/fragment@22/__overlay__:vdda-phy-supply:0";
		L18A = "/fragment@22/__overlay__:vdda-pll-supply:0\0/fragment@23/__overlay__:qcom,vddp-ref-clk-supply:0";
		ufshc_mem = "/fragment@23:target:0";
		gcc_ufs_phy_gdsc = "/fragment@23/__overlay__:vdd-hba-supply:0";
		usb_qmp_dp_phy = "/fragment@24:target:0";
		pm6125_vadc = "/fragment@25:target:0\0/fragment@26/__overlay__:io-channels:0\0/fragment@26/__overlay__:io-channels:8\0/fragment@26/__overlay__:io-channels:16\0/fragment@26/__overlay__:io-channels:24";
		camera_therm_default = "/fragment@25/__overlay__:pinctrl-0:0";
		emmc_therm_default = "/fragment@25/__overlay__:pinctrl-0:4";
		pm6125_adc_tm = "/fragment@26:target:0\0/fragment@27/__overlay__/rf-pa1-therm-usr:thermal-sensors:0";
		pm8008_8 = "/fragment@30:target:0";
		pm8008_9 = "/fragment@31:target:0";
		qupv3_se2_i2c = "/fragment@33:target:0";
		ts_int_active = "/fragment@33/__overlay__/novatek@62:pinctrl-0:0";
		ts_reset_active = "/fragment@33/__overlay__/novatek@62:pinctrl-0:4";
		ts_int_suspend = "/fragment@33/__overlay__/novatek@62:pinctrl-1:0";
		ts_reset_suspend = "/fragment@33/__overlay__/novatek@62:pinctrl-1:4";
		ts_release = "/fragment@33/__overlay__/novatek@62:pinctrl-2:0";
		usb0 = "/fragment@34:target:0";
		eud = "/fragment@34/__overlay__:extcon:8";
	};

	__local_fixups__ {

		fragment@0 {

			__overlay__ {

				bolero-clk-rsc-mngr {
					clocks = <0x00 0x08 0x10 0x18 0x20 0x28>;
				};

				tx-macro@a620000 {
					clocks = <0x00 0x08>;
				};

				rx-macro@a600000 {
					clocks = <0x00 0x08>;
				};

				wcd937x-codec {
					qcom,wcd-rst-gpio-node = <0x00>;
					qcom,rx-slave = <0x00>;
					qcom,tx-slave = <0x00>;
				};
			};
		};

		fragment@1 {

			__overlay__ {
				qcom,codec-aux-devs = <0x00>;
			};
		};

		fragment@2 {

			__overlay__ {

				wsa881x-i2c-codec@e {
					clocks = <0x00>;
					qcom,wsa-analog-reset-gpio = <0x00>;
				};
			};
		};

		fragment@3 {

			__overlay__ {

				aw87xxx_pa_reset_gpio {
					audio-reset-pin = <0x00>;
				};
			};
		};

		fragment@8 {

			__overlay__ {

				qcom,mdss_dsi_panel_k7_38_0c_0a_fhdp_video {
					qcom,panel-supply-entries = <0x00>;
				};
			};
		};

		fragment@9 {

			__overlay__ {

				qcom,mdss_dsi_panel_k7_38_0c_0b_fhdp_video {
					qcom,panel-supply-entries = <0x00>;
				};
			};
		};

		fragment@10 {

			__overlay__ {

				qcom,mdss_dsi_nt36672e_fhd_plus_90hz_video {
					qcom,panel-supply-entries = <0x00>;
					qcom,platform-en-gpio = <0x00>;
					qcom,platform-bklight-en-gpio = <0x00>;
				};
			};
		};

		fragment@12 {

			__overlay__ {

				qcom,mdss_dsi_sim_video {
					qcom,panel-supply-entries = <0x00>;
				};
			};
		};

		fragment@13 {

			__overlay__ {

				qcom,dsi-display-primary {
					pinctrl-0 = <0x08>;
					qcom,dsi-default-panel = <0x00>;
				};

				qcom,msm_notifier@0 {
					panel = <0x00 0x04>;
				};
			};
		};

		fragment@14 {

			__overlay__ {
				connectors = <0x00>;
			};
		};

		fragment@15 {

			__overlay__ {

				qcom,pm7250b@2 {

					qcom,qpnp-smb5 {
						qcom,pmic-revid = <0x00>;
						io-channels = <0x00 0x08 0x10 0x18 0x20 0x28 0x30>;
					};

					qcom,usb-pdphy@1700 {
						vbus-supply = <0x00>;
						vconn-supply = <0x00>;
					};

					qcom,temp-alarm@2400 {
						io-channels = <0x00>;
					};

					qpnp,qg {
						qcom,pmic-revid = <0x00>;
						io-channels = <0x00 0x08>;
					};

					clock-controller@5b00 {
						assigned-clocks = <0x00>;
					};

					adc_tm@3500 {
						io-channels = <0x00 0x08>;
					};
				};
			};
		};

		fragment@16 {

			__overlay__ {

				pm7250b-tz {
					thermal-sensors = <0x00>;
				};

				pm7250b-ibat-lvl0 {
					thermal-sensors = <0x00>;
				};

				pm7250b-ibat-lvl1 {
					thermal-sensors = <0x00>;
				};

				pm7250b-vbat-lvl0 {
					thermal-sensors = <0x00>;
				};

				pm7250b-vbat-lvl1 {
					thermal-sensors = <0x00>;
				};

				pm7250b-vbat-lvl2 {
					thermal-sensors = <0x00>;
				};

				pm7250b-bcl-lvl0 {
					thermal-sensors = <0x00>;
				};

				pm7250b-bcl-lvl1 {
					thermal-sensors = <0x00>;
				};

				pm7250b-bcl-lvl2 {
					thermal-sensors = <0x00>;
				};

				soc {
					thermal-sensors = <0x00>;
				};
			};
		};

		fragment@17 {

			__overlay__ {

				charger-therm-usr {
					thermal-sensors = <0x00>;
				};

				conn-therm-usr {
					thermal-sensors = <0x00>;
				};
			};
		};

		fragment@19 {

			__overlay__ {

				vdda_usb_ss_dp_core {
					pinctrl-0 = <0x00>;
				};
			};
		};

		fragment@24 {

			__overlay__ {
				vdd-supply = <0x00>;
			};
		};

		fragment@25 {

			__overlay__ {
				pinctrl-0 = <0x08>;
			};
		};

		fragment@29 {

			__overlay__ {

				gpio_keys {
					pinctrl-0 = <0x00>;
				};
			};
		};

		fragment@33 {

			__overlay__ {

				novatek@62 {
					panel = <0x00>;
				};
			};
		};

		fragment@34 {

			__overlay__ {
				extcon = <0x00 0x04>;
			};
		};
	};
};
